# AE101F4071542LH_CM55_HE_View register map
Vendor: Alif Semiconductor; Series: E1; File version: 1.0
The families of fusion processors and microcontrollers (MCUs) from Alif Semiconductor create a scalable and compatible continuum of highly integrated embedded processor devices for use in low-end to high-end intelligent IoT end-point applications. Architected for power efficiency and long battery life, these devices deliver high computation and ML/AI capability, multi-layered security, computer vision, and highly interactive human-machine interface.
CPU: CM55 r1p0, selectable endian, MPU, FPU, double-precision FPU, DSP, VTOR, 8 interrupt priority bits, 1 SAU regions
Registers are 32-bit, read-write, reset 0x0 unless marked. A register's access mark holds for its fields unless they carry their own. Offsets are from the block's base; lines under a group give offsets from that group; [hi:lo] are bit positions; {n}, {i} and the like mark numbered series; 'fields as' and 'values as' point back to an identical list; <NAME> marks a mode.

## Memory map
0x1A010000 CLKCTL_SYS blocks up to offset 0x828
0x1A200000 REFCLK_CNTControl size 0x10
0x1A210000 REFCLK_CNTRead size 0x8
0x1A220000 REFCLK_CNTCtl size 0xA0
0x1A230000 REFCLK_CNTBase0 size 0x40
0x1A240000 REFCLK_CNTBase1 size 0x40
0x1A250000 REFCLK_CNTBase2 size 0x40
0x1A260000 REFCLK_CNTBase3 size 0x40
0x1A400000 S32K_CNTControl size 0x10
0x1A410000 S32K_CNTRead size 0x8
0x1A420000 S32K_CNTCtl size 0xA0
0x1A430000 S32K_CNTBase0 size 0x40
0x1A440000 S32K_CNTBase1 size 0x40
0x1A500000 IRQRTR size 0xFB4
0x1A602000 CGU size 0x24
0x1A603000 PINMUX size 0x1E0
0x1A604000 AON blocks up to offset 0x44
0x1A609000 VBAT size 0x14
0x1A60A000 ANA size 0x44
0x1A60F000 STOP_MODE size 0x4
0x40040000 MHU_SECPU_M55HE_0_RX size 0x1000
0x40050000 MHU_M55HE_SECPU_0_TX size 0x1000
0x40060000 MHU_SECPU_M55HE_1_RX size 0x1000
0x40070000 MHU_M55HE_SECPU_1_TX size 0x1000
0x400C0000 DMA2_SEC size 0x1000
0x400E0000 DMA2_NS size 0x1000
0x400E1000 NPU_HE size 0x1000
0x400E2000 EVTRTR2 size 0x94
0x40100000 WDT_HE_CTRL size 0x1000
0x40101000 WDT_HE_REFRESH size 0x1000
0x42000000 LPRTC0 size 0x28
0x42001000 LPTIMER size 0xB0
0x42002000 LPGPIO size 0x78
0x42007000 LPGPIO_CTRL size 0x20
0x43000000 LPSPI0 size 0xF0
0x43001000 LPI2S size 0x204
0x43002000 LPPDM size 0x7D8
0x43003000 LPCPI size 0x34
0x43007000 M55HE_CFG size 0x24
0x43008000 LPUART size 0x100
0x43009000 LPI2C size 0x24
0x48000000 UTIMER size 0x10138
0x48102000 SDMMC size 0xF70
0x48103000 SPI0 size 0xF4
0x48104000 SPI1 size 0xF4
0x48105000 SPI2 size 0xF4
0x48106000 SPI3 size 0xF4
0x48107000 CRC0 size 0x100
0x48108000 CRC1 size 0x100
0x48200000 USB size 0xCA04
{0x49000000+0x1000*n} GPIO{n} size 0x78 (n=0..14)
0x49010000 I2C0 size 0x100
0x49011000 I2C1 size 0x100
0x49012000 I2C2 size 0x100
0x49013000 I2C3 size 0x100
0x49014000 I2S0 size 0x204
0x49015000 I2S1 size 0x204
0x49018000 UART0 size 0x100
0x49019000 UART1 size 0x100
0x4901A000 UART2 size 0x100
0x4901B000 UART3 size 0x100
0x4901C000 UART4 size 0x100
0x4901D000 UART5 size 0x100
0x49020000 ADC120 size 0x74
0x49021000 ADC121 size 0x74
0x49023000 CMP0 size 0x28
0x49024000 CMP1 size 0x28
0x49027000 ADC24 size 0x74
0x49028000 DAC12 size 0x8
0x4902D000 PDM size 0x7D8
{0x4902E000+0x10*n} HWSEM{n} size 0xC (n=0..15)
0x4902F000 CLKCTL_PER_SLV size 0xBC
0x49031000 CDC size 0x254
0x49032000 DSI size 0x194
0x49034000 I3C size 0x224
0x49035000 EVTRTR0 size 0xA0
0x49036000 CANFD0 size 0xD1
0x49037000 CANFD0_CNT size 0xC
0x4903F000 CLKCTL_PER_MST blocks up to offset 0xB0
0x49040000 GPU2D size 0xEC
0x49080000 DMA0_SEC size 0x1000
0x490A0000 DMA0_NS size 0x1000
0x83000000 OSPI size 0x14C
0x83001000 AES size 0x24
0xE000E100 M55HE_NVIC_S size 0x4E0
0xE002E100 M55HE_NVIC_NS size 0x4E0

## Interrupts
{n} DMA2_IRQ{n} (DMA2_SEC, DMA2_NS) (n=0..31) — Interrupt request {n}. One per DMA request interface (32 in total).
32 DMA2_IRQ_ABORT (DMA2_SEC, DMA2_NS) — DMAC aborted execution of a program thread.
37 MHU_SECPU_M55HE_0_RX_IRQ (MHU_SECPU_M55HE_0_RX) — Interrupt
38 MHU_M55HE_SECPU_0_TX_IRQ (MHU_M55HE_SECPU_0_TX) — Interrupt
39 MHU_SECPU_M55HE_1_RX_IRQ (MHU_SECPU_M55HE_1_RX) — Interrupt
40 MHU_M55HE_SECPU_1_TX_IRQ (MHU_M55HE_SECPU_1_TX) — Interrupt
45 LPUART_IRQ (LPUART) — LPUART interrupt request
46 LPSPI0_IRQ (LPSPI0) — LPSPI0 interrupt request
47 LPI2C_IRQ (LPI2C) — LPI2C interrupt request
48 LPI2S_IRQ (LPI2S) — LPI2S interrupt request
49 LPPDM_IRQ (LPPDM) — LPPDM combined (OR-ed) interrupt of following requests : Warning interrupt request (WARN_IRQ) Error interrupt request (ERROR_IRQ) Audio peak detection interrupt request (AUDIO_DET_IRQ) Upon interrupt assertion, the LPPDM interrupt status registers should be read to identify the source of the interrupt.
54 LPCAM_IRQ (LPCPI) — LPCPI interrupt
57 LPGPIO_COMB_IRQ (LPGPIO) — LPGPIO combined interrupt request
58 LPRTC0_IRQ (LPRTC0) — LPRTC0 interrupt request
60 LPTIMER0_IRQ (LPTIMER) — LPTIMER0 interrupt request
61 LPTIMER1_IRQ (LPTIMER) — LPTIMER1 interrupt request
67 REFCLK_CNTBASE0_IRQ (REFCLK_CNTBase0) — Interrupt generated when the timer condition is met. See registers CNTP_TVAL and CNTP_CTL for the timer condition definition.
68 REFCLK_CNTBASE1_IRQ (REFCLK_CNTBase1) — Interrupt generated when the timer condition is met. See registers CNTP_TVAL and CNTP_CTL for the timer condition definition.
69 REFCLK_CNTBASE2_IRQ (REFCLK_CNTBase2) — Interrupt generated when the timer condition is met. See registers CNTP_TVAL and CNTP_CTL for the timer condition definition.
70 REFCLK_CNTBASE3_IRQ (REFCLK_CNTBase3) — Interrupt generated when the timer condition is met. See registers CNTP_TVAL and CNTP_CTL for the timer condition definition.
71 S32K_CNTBASE0_IRQ (S32K_CNTBase0) — Interrupt generated when the timer condition is met. See registers CNTP_TVAL and CNTP_CTL for the timer condition definition.
72 S32K_CNTBASE1_IRQ (S32K_CNTBase1) — Interrupt generated when the timer condition is met. See registers CNTP_TVAL and CNTP_CTL for the timer condition definition.
96 OSPI0_IRQ (OSPI)
98 AES0_IRQ (AES)
101 USB_IRQ (USB) — USB interrupt
102 SDMMC_IRQ (SDMMC) — SDMMC Interrupt request
103 SDMMC_WAKEUP_IRQ (SDMMC) — SDMMC Wakeup event interrupt request
104 CANFD0_IRQ (CANFD0) — CANFD0 Interrupt request
{n+105} HWSEM_IRQ{n} (HWSEM{n}) (n=0..15) — HWSEM interrupt request {n}
124 UART0_IRQ (UART0) — UART0 interrupt request
125 UART1_IRQ (UART1) — UART1 interrupt request
126 UART2_IRQ (UART2) — UART2 interrupt request
127 UART3_IRQ (UART3) — UART3 interrupt request
128 UART4_IRQ (UART4) — UART4 interrupt request
129 UART5_IRQ (UART5) — UART5 interrupt request
132 I2C0_IRQ (I2C0) — I2C0 interrupt request
133 I2C1_IRQ (I2C1) — I2C1 interrupt request
134 I2C2_IRQ (I2C2) — I2C2 interrupt request
135 I2C3_IRQ (I2C3) — I2C3 interrupt request
136 I3C_IRQ (I3C) — I3C interrupt request
137 SPI0_IRQ (SPI0) — SPI0 interrupt request
138 SPI1_IRQ (SPI1) — SPI1 interrupt request
139 SPI2_IRQ (SPI2) — SPI2 interrupt request
140 SPI3_IRQ (SPI3) — SPI3 interrupt request
141 I2S0_IRQ (I2S0) — I2S0 interrupt request
142 I2S1_IRQ (I2S1) — I2S1 interrupt request
145 PDM_WARN_IRQ (PDM) — PDM Warning interrupt request
146 PDM_ERROR_IRQ (PDM) — PDM Error interrupt request
147 PDM_AUDIO_DET_IRQ (PDM) — PDM Audio peak detection interrupt request
151 ADC120_DONE0_IRQ (ADC120) — Averaged sample ready
152 ADC121_DONE0_IRQ (ADC121) — Averaged sample ready
154 ADC120_DONE1_IRQ (ADC120) — All samples taken
155 ADC121_DONE1_IRQ (ADC121) — All samples taken
157 ADC120_CMPA_IRQ (ADC120) — Comparator A interrupt
158 ADC121_CMPA_IRQ (ADC121) — Comparator A interrupt
160 ADC120_CMPB_IRQ (ADC120) — Comparator B interrupt
161 ADC121_CMPB_IRQ (ADC121) — Comparator B interrupt
163 ADC24_DONE0_IRQ (ADC24) — Averaged sample ready
164 ADC24_DONE1_IRQ (ADC24) — All samples taken
165 ADC24_CMPA_IRQ (ADC24) — Comparator A interrupt
166 ADC24_CMPB_IRQ (ADC24) — Comparator B interrupt
167 CMP0_IRQ (CMP0) — Comparator result changed
168 CMP1_IRQ (CMP1) — Comparator result changed
{n+171} LPGPIO_IRQ{n} (LPGPIO) (n=0..7) — LPGPIO interrupt request {n}
{8n+179} GPIO{n}_IRQ0 (GPIO{n}) (n=0..14) — GPIO{n} interrupt request 0
{8n+180} GPIO{n}_IRQ1 (GPIO{n}) (n=0..14) — GPIO{n} interrupt request 1
{8n+181} GPIO{n}_IRQ2 (GPIO{n}) (n=0..14) — GPIO{n} interrupt request 2
{8n+182} GPIO{n}_IRQ3 (GPIO{n}) (n=0..14) — GPIO{n} interrupt request 3
{8n+183} GPIO{n}_IRQ4 (GPIO{n}) (n=0..14) — GPIO{n} interrupt request 4
{8n+184} GPIO{n}_IRQ5 (GPIO{n}) (n=0..14) — GPIO{n} interrupt request 5
{8n+185} GPIO{n}_IRQ6 (GPIO{n}) (n=0..14) — GPIO{n} interrupt request 6
{8n+186} GPIO{n}_IRQ7 (GPIO{n}) (n=0..14) — GPIO{n} interrupt request 7
{n+299} DMA0_IRQ{n} (DMA0_SEC, DMA0_NS) (n=0..31) — Interrupt request {n}. One per DMA request interface (32 in total).
331 DMA0_IRQ_ABORT (DMA0_SEC, DMA0_NS) — DMAC aborted execution of a program thread.
332 GPU2D_IRQ (GPU2D) — GPU2D aggregated interrupt request
333 CDC_SCANLINE0_IRQ (CDC) — CDC line interrupt
335 CDC_FIFO_WARNING0_IRQ (CDC) — CDC FIFO underrun warning interrupt
337 CDC_FIFO_UNDERRUN0_IRQ (CDC) — CDC layer FIFO underrun interrupt
339 CDC_BUS_ERROR0_IRQ (CDC) — CDC bus error interrupt
341 CDC_REG_RELOAD0_IRQ (CDC) — CDC register reload interrupt
343 DSI_IRQ (DSI) — DSI error interrupt
369 QEC0_CMPA_IRQ (UTIMER) — Channel 12 interrupt request at driver A
370 QEC0_CMPB_IRQ (UTIMER) — Channel 12 interrupt request at driver B
371 QEC1_CMPA_IRQ (UTIMER) — Channel 13 interrupt request at driver A
372 QEC1_CMPB_IRQ (UTIMER) — Channel 13 interrupt request at driver B
373 QEC2_CMPA_IRQ (UTIMER) — Channel 14 interrupt request at driver A
374 QEC2_CMPB_IRQ (UTIMER) — Channel 14 interrupt request at driver B
375 QEC3_CMPA_IRQ (UTIMER) — Channel 15 interrupt request at driver A
376 QEC3_CMPB_IRQ (UTIMER) — Channel 15 interrupt request at driver B
{n+377} UTIMER_IRQ{n} (UTIMER) (n=0..7) — Channel 0, interrupt request {n}
{n+377} UTIMER_IRQ{n} (UTIMER) (n=8..15) — Channel 1, interrupt request {n}
{n+377} UTIMER_IRQ{n} (UTIMER) (n=16..23) — Channel 2, interrupt request {n}
{n+377} UTIMER_IRQ{n} (UTIMER) (n=24..31) — Channel 3, interrupt request {n}
{n+377} UTIMER_IRQ{n} (UTIMER) (n=32..39) — Channel 4, interrupt request {n}
{n+377} UTIMER_IRQ{n} (UTIMER) (n=40..47) — Channel 5, interrupt request {n}
{n+377} UTIMER_IRQ{n} (UTIMER) (n=48..55) — Channel 6, interrupt request {n}
{n+377} UTIMER_IRQ{n} (UTIMER) (n=56..63) — Channel 7, interrupt request {n}

## Further device data
features: package=FBGA194 ioPins=96 sramSize=4.5 mramSize=1.5 ospiSize=512 securityType=Enclave gpuType=2D GPU displayType=24b Parallel + MIPI DSI cameraType=8-16b Parallel temp=-40,105 adc12=2,12 adc24=1,24 dac=2,12 cmp=2 timer=8,32 qec=4,32 i2c=4 i2s=2 can=1 eth=0 ospi=1 sdio=1,8 spi=4,50000000 uart=6,2500000 usbotg=1
books:
  https://alifsemi.com/download/ADTS0008 type=Datasheet title=E1 Datasheet
  https://alifsemi.com/download/AERR0008 type=ERRATA title=Ensemble Family Functional Errata
  https://alifsemi.com/download/AHRM0008 type=Hardware Reference Manual title=E1 Hardware Reference Manual
  https://swrm.alifsemi.com type=SWRM title=Software Reference Manual
cpus:
  M55-HE core=Cortex-M55 revision=r1p0 endian=Configurable mpuPresent=true fpuPresent=true fpuDP=true dspPresent=true vtorPresent=true nvicPrioBits=8 vendorSystickConfig=false sauNumRegions=1 pmuPresent=true pmuNumEventCnt=8 mvePresent=true mveFP=true tzPresent=true cpuClock=160000000
memories:
  Utility_SRAM start=0x4902C000 size=0x00001000 access=rw default=1
  SRAM0 start=0x02000000 size=0x00400000 access=rw default=1
  SRAM4 start=0x58000000 size=0x00040000 access=rw default=1
  SRAM5 start=0x58800000 size=0x00040000 access=rw default=1
  MRAM start=0x80000000 size=0x00180000 access=rx default=1
  OSPI start=0xA0000000 size=0x20000000 access=rwx default=1
firewalls:
  FCTLR ProtectionExtension=PE.1 MonitorExtension=ME.0 TranslationExtension=TE.0 RegionSizeExtension=RSE.1 num_rgn=3 mnrs=4KB mxrs=2MB num_mpe=1 single_mst=0 location=Slave side protectedRegion=0x1A80_0000 - 0x1A8E_FFFF
  FC1 ProtectionExtension=PE.1 MonitorExtension=ME.0 TranslationExtension=TE.0 RegionSizeExtension=RSE.0 num_rgn=22 mnrs=4KB mxrs=512MB num_mpe=1 single_mst=0 location=Slave side protectedRegion=0x1000_0000 - 0x17FF_FFFF, 0x1B00_0000 - 0x1E0F_FFFF
  FC2 ProtectionExtension=PE.1 MonitorExtension=ME.0 TranslationExtension=TE.0 RegionSizeExtension=RSE.0 num_rgn=1 mnrs=4KB mxrs=512MB num_mpe=1 single_mst=0 location=Slave side protectedRegion=0x1800_0000 - 0x19FF_FFFF
  FC3 ProtectionExtension=PE.1 MonitorExtension=ME.0 TranslationExtension=TE.0 RegionSizeExtension=RSE.0 num_rgn=40 mnrs=4KB mxrs=8MB num_mpe=1 single_mst=0 location=Slave side protectedRegion=0x1A00_0000 - 0x1A60_FFFF
  FC5 ProtectionExtension=PE.2 MonitorExtension=ME.0 TranslationExtension=TE.0 RegionSizeExtension=RSE.1 num_rgn=32 mnrs=256B mxrs=32MB num_mpe=4 single_mst=0 location=Slave side protectedRegion=0x0200_0000 - 0x03FF_FFFF
  FC8 ProtectionExtension=PE.2 MonitorExtension=ME.2 TranslationExtension=TE.2 RegionSizeExtension=RSE.1 num_rgn=16 mnrs=4KB mxrs=4GB num_mpe=1 single_mst=1 location=Master side protectedRegion=M55-HE address map (0x0000_0000 - 0xFFFF_FFFF)
  FC9 ProtectionExtension=PE.2 MonitorExtension=ME.2 TranslationExtension=TE.2 RegionSizeExtension=RSE.1 num_rgn=32 mnrs=4KB mxrs=4GB num_mpe=4 single_mst=0 location=Master side protectedRegion=Reserved
  FC11 ProtectionExtension=PE.2 MonitorExtension=ME.0 TranslationExtension=TE.0 RegionSizeExtension=RSE.1 num_rgn=32 mnrs=256B mxrs=512MB num_mpe=4 single_mst=0 location=Slave side protectedRegion=0x4000_0000 - 0x5FFF_FFFF
  FC13 ProtectionExtension=PE.2 MonitorExtension=ME.0 TranslationExtension=TE.0 RegionSizeExtension=RSE.1 num_rgn=32 mnrs=4KB mxrs=2GB num_mpe=4 single_mst=0 location=Slave side protectedRegion=0x8000_0000 - 0xDFFF_FFFF
  FC14 ProtectionExtension=PE.2 MonitorExtension=ME.2 TranslationExtension=TE.2 RegionSizeExtension=RSE.1 num_rgn=8 mnrs=4KB mxrs=4GB num_mpe=2 single_mst=0 location=Master side protectedRegion=Reserved
pins:
  P0_0 location=R19 register=P0_0 offset=0x0 muxModes=GPIO0_0, OSPI0_D0_A, UART0_RX_A, I3C_SDA_A, UT0_T0_A, LPCAM_HSYNC_B, Reserved, ANA_S0
  P0_1 location=R13 register=P0_1 offset=0x4 muxModes=GPIO0_1, OSPI0_D1_A, UART0_TX_A, I3C_SCL_A, UT0_T1_A, LPCAM_VSYNC_B, Reserved, ANA_S1
  P0_2 location=R12 register=P0_2 offset=0x8 muxModes=GPIO0_2, OSPI0_D2_A, UART0_CTS_A, I2C0_SDA_A, UT1_T0_A, LPCAM_PCLK_B, Reserved, ANA_S2
  P0_3 location=R11 register=P0_3 offset=0xC muxModes=GPIO0_3, OSPI0_D3_A, UART0_RTS_A, I2C0_SCL_A, UT1_T1_A, LPCAM_XVCLK_B, Reserved, ANA_S3
  P0_4 location=R10 register=P0_4 offset=0x10 muxModes=GPIO0_4, OSPI0_D4_A, UART1_RX_A, PDM_D0_A, I2C1_SDA_A, UT2_T0_A, CAN_RXD_B, ANA_S4
  P0_5 location=N15 register=P0_5 offset=0x14 muxModes=GPIO0_5, OSPI0_D5_A, UART1_TX_A, PDM_C0_A, I2C1_SCL_A, UT2_T1_A, CAN_TXD_B, ANA_S5
  P0_6 location=P15 register=P0_6 offset=0x18 muxModes=GPIO0_6, OSPI0_D6_A, UART1_CTS_A, PDM_D1_A, I2C2_SCL_A, UT3_T0_A, CAN_STBY_B, ANA_S6
  P0_7 location=R15 register=P0_7 offset=0x1C muxModes=GPIO0_7, OSPI0_D7_A, UART1_RTS_A, PDM_C1_A, I2C2_SDA_A, UT3_T1_A, CDC_DE_B, ANA_S7
  P1_0 location=R14 register=P1_0 offset=0x20 muxModes=GPIO1_0, UART2_RX_A, SPI0_MISO_A, I2C3_SDA_A, UT4_T0_A, LPCAM_HSYNC_C, Reserved, ANA_S8
  P1_1 location=M15 register=P1_1 offset=0x24 muxModes=GPIO1_1, UART2_TX_A, SPI0_MOSI_A, I2C3_SCL_A, UT4_T1_A, LPCAM_VSYNC_C, Reserved, ANA_S9
  P1_2 location=L15 register=P1_2 offset=0x28 muxModes=GPIO1_2, UART3_RX_A, SPI0_SCLK_A, I3C_SDA_B, UT5_T0_A, LPCAM_PCLK_C, Reserved, ANA_S10
  P1_3 location=K15 register=P1_3 offset=0x2C muxModes=GPIO1_3, UART3_TX_A, SPI0_SS0_A, I3C_SCL_B, UT5_T1_A, LPCAM_XVCLK_C, Reserved, ANA_S11
  P1_4 location=M19 register=P1_4 offset=0x30 muxModes=GPIO1_4, OSPI0_SS0_A, UART0_RX_B, SPI0_SS1_A, UT6_T0_A, LPCAM_D0_C, Reserved, ANA_S12
  P1_5 location=L18 register=P1_5 offset=0x34 muxModes=GPIO1_5, OSPI0_SS1_A, UART0_TX_B, SPI0_SS2_A, UT6_T1_A, LPCAM_D1_C, Reserved, ANA_S13
  P1_6 location=L19 register=P1_6 offset=0x38 muxModes=GPIO1_6, OSPI0_RXDS_B, UART1_RX_B, I2S0_SDI_A, UT7_T0_A, LPCAM_D2_C, Reserved, ANA_S14
  P1_7 location=J18 register=P1_7 offset=0x3C muxModes=GPIO1_7, OSPI0_SCLK_A, UART1_TX_B, I2S0_SDO_A, UT7_T1_A, LPCAM_D3_C, Reserved, ANA_S15
  P2_0 location=K19 register=P2_0 offset=0x40 muxModes=GPIO2_0, OSPI0_D0_B, UART2_RX_B, LPPDM_D0_A, Reserved, LPCAM_D4_C, Reserved, ANA_S16
  P2_1 location=K18 register=P2_1 offset=0x44 muxModes=GPIO2_1, OSPI0_D1_B, UART2_TX_B, LPPDM_C0_A, Reserved, LPCAM_D5_C, Reserved, ANA_S17
  P2_2 location=J15 register=P2_2 offset=0x48 muxModes=GPIO2_2, OSPI0_D2_B, UART3_RX_B, LPPDM_D1_A, Reserved, LPCAM_D6_C, Reserved, ANA_S18
  P2_3 location=H15 register=P2_3 offset=0x4C muxModes=GPIO2_3, OSPI0_D3_B, UART3_TX_B, LPPDM_C1_A, Reserved, LPCAM_D7_C, CDC_PCLK_B, ANA_S19
  P2_4 location=G19 register=P2_4 offset=0x50 muxModes=GPIO2_4, OSPI0_D4_B, LPI2S_SDI_A, SPI1_MISO_A, Reserved, LPCAM_D0_B, Reserved, ANA_S20
  P2_5 location=H19 register=P2_5 offset=0x54 muxModes=GPIO2_5, OSPI0_D5_B, LPI2S_SDO_A, SPI1_MOSI_A, Reserved, LPCAM_D1_B, Reserved, ANA_S21
  P2_6 location=H18 register=P2_6 offset=0x58 muxModes=GPIO2_6, OSPI0_D6_B, LPI2S_SCLK_A, SPI1_SCLK_A, Reserved, LPCAM_D2_B, Reserved, ANA_S22
  P2_7 location=J19 register=P2_7 offset=0x5C muxModes=GPIO2_7, OSPI0_D7_B, LPI2S_WS_A, SPI1_SS0_A, Reserved, LPCAM_D3_B, Reserved, ANA_S23
  P3_0 location=B6 register=P3_0 offset=0x60 muxModes=GPIO3_0, OSPI0_SCLK_B, UART4_RX_A, PDM_D0_B, I2S0_SCLK_A, QEC0_X_A, LPCAM_D4_B, Reserved
  P3_1 location=A6 register=P3_1 offset=0x64 muxModes=GPIO3_1, OSPI0_SCLKN_B, UART4_TX_A, PDM_C0_B, I2S0_WS_A, QEC0_Y_A, LPCAM_D5_B, Reserved
  P3_2 location=E2 register=P3_2 offset=0x68 muxModes=GPIO3_2, OSPI0_SS0_B, PDM_D1_B, I2S1_SDI_A, I3C_SDA_C, QEC0_Z_A, LPCAM_D6_B, Reserved
  P3_3 location=G2 register=P3_3 offset=0x6C muxModes=GPIO3_3, OSPI0_SS1_B, PDM_C1_B, I2S1_SDO_A, I3C_SCL_C, QEC1_X_A, LPCAM_D7_B, Reserved
  P3_4 location=F2 register=P3_4 offset=0x70 muxModes=GPIO3_4, OSPI0_RXDS_A, UART5_RX_A, LPPDM_C0_B, I2S1_SCLK_A, I2C0_SCL_B, QEC1_Y_A, Reserved
  P3_5 location=F1 register=P3_5 offset=0x74 muxModes=GPIO3_5, OSPI0_SCLKN_A, UART5_TX_A, LPPDM_D0_B, SPI0_SS1_B, I2C0_SDA_B, QEC1_Z_A, Reserved
  P3_6 location=V5 register=P3_6 offset=0x78 muxModes=GPIO3_6, Reserved, LPUART_CTS_B, LPPDM_C1_B, SPI0_SS2_B, I2C1_SDA_B, QEC2_X_A, Reserved
  P3_7 location=L8 register=P3_7 offset=0x7C muxModes=GPIO3_7, JTAG_TRACECLK, LPUART_RTS_B, LPPDM_D1_B, SPI1_SS1_A, I2C1_SCL_B, QEC2_Y_A, Reserved
  P4_0 location=F18 register=P4_0 offset=0x80 muxModes=GPIO4_0, JTAG_TDATA0, Reserved, I2S1_WS_A, SPI1_SS2_A, QEC2_Z_A, CDC_VSYNC_B, Reserved
  P4_1 location=B19 register=P4_1 offset=0x84 muxModes=GPIO4_1, JTAG_TDATA1, I2S0_SDI_B, SPI1_SS3_A, QEC3_X_A, SD_CLK_D, CDC_HSYNC_B, Reserved
  P4_2 location=C19 register=P4_2 offset=0x88 muxModes=GPIO4_2, JTAG_TDATA2, Reserved, I2S0_SDO_B, SPI2_MISO_A, QEC3_Y_A, SD_CMD_D, Reserved
  P4_3 location=B18 register=P4_3 offset=0x8C muxModes=GPIO4_3, JTAG_TDATA3, Reserved, I2S0_SCLK_B, SPI2_MOSI_A, QEC3_Z_A, SD_RST_D, Reserved
  P4_4 location=B17 register=P4_4 offset=0x90 muxModes=GPIO4_4, JTAG_TCK, I2S0_WS_B, SPI2_SCLK_A, FAULT0_A
  P4_5 location=A19 register=P4_5 offset=0x94 muxModes=GPIO4_5, JTAG_TMS, SPI2_SS0_A, FAULT1_A
  P4_6 location=A18 register=P4_6 offset=0x98 muxModes=GPIO4_6, JTAG_TDI, SPI2_SS1_A, FAULT2_A
  P4_7 location=B16 register=P4_7 offset=0x9C muxModes=GPIO4_7, JTAG_TDO, SPI2_SS2_A, FAULT3_A
  P5_0 location=A16 register=P5_0 offset=0xA0 muxModes=GPIO5_0, Reserved, UART4_RX_C, PDM_D2_A, SPI0_MISO_B, I2C2_SDA_B, UT0_T0_B, SD_D0_A
  P5_1 location=B14 register=P5_1 offset=0xA4 muxModes=GPIO5_1, Reserved, UART4_TX_C, PDM_D3_A, SPI0_MOSI_B, I2C2_SCL_B, UT0_T1_B, SD_D1_A
  P5_2 location=E12 register=P5_2 offset=0xA8 muxModes=GPIO5_2, Reserved, UART5_RX_C, PDM_C3_A, SPI0_SS0_B, LPI2C_SCL_B, UT1_T0_B, SD_D2_A
  P5_3 location=B13 register=P5_3 offset=0xAC muxModes=GPIO5_3, Reserved, UART5_TX_C, SPI0_SCLK_B, LPI2C_SDA_B, UT1_T1_B, SD_D3_A, CDC_PCLK_A
  P5_4 location=E11 register=P5_4 offset=0xB0 muxModes=GPIO5_4, Reserved, UART3_CTS_A, PDM_D2_B, SPI0_SS3_A, UT2_T0_B, SD_D4_A, CDC_DE_A
  P5_5 location=E10 register=P5_5 offset=0xB4 muxModes=GPIO5_5, Reserved, UART3_RTS_A, PDM_D3_B, UT2_T1_B, SD_D5_A, Reserved, CDC_HSYNC_A
  P5_6 location=B12 register=P5_6 offset=0xB8 muxModes=GPIO5_6, Reserved, UART1_CTS_B, I2C2_SCL_C, UT3_T0_B, SD_D6_A, Reserved, CDC_VSYNC_A
  P5_7 location=B11 register=P5_7 offset=0xBC muxModes=GPIO5_7, Reserved, UART1_RTS_B, I2C2_SDA_C, UT3_T1_B, SD_D7_A, Reserved
  P6_0 location=A12 register=P6_0 offset=0xC0 muxModes=GPIO6_0, OSPI0_D0_C, UART4_DE_A, PDM_D0_C, UT4_T0_B, SD_D0_D, Reserved
  P6_1 location=E9 register=P6_1 offset=0xC4 muxModes=GPIO6_1, OSPI0_D1_C, UART5_DE_A, PDM_C0_C, UT4_T1_B, SD_D1_D, Reserved
  P6_2 location=A11 register=P6_2 offset=0xC8 muxModes=GPIO6_2, OSPI0_D2_C, UART2_CTS_A, Reserved, PDM_D1_C, UT5_T0_B, SD_D2_D, Reserved
  P6_3 location=B10 register=P6_3 offset=0xCC muxModes=GPIO6_3, OSPI0_D3_C, UART2_RTS_A, Reserved, PDM_C1_C, UT5_T1_B, SD_D3_D, Reserved
  P6_4 location=E8 register=P6_4 offset=0xD0 muxModes=GPIO6_4, OSPI0_D4_C, UART2_CTS_B, Reserved, SPI1_SS0_B, UT6_T0_B, SD_D4_D, Reserved
  P6_5 location=E7 register=P6_5 offset=0xD4 muxModes=GPIO6_5, OSPI0_D5_C, UART2_RTS_B, Reserved, SPI1_SS1_B, UT6_T1_B, SD_D5_D, Reserved
  P6_6 location=E6 register=P6_6 offset=0xD8 muxModes=GPIO6_6, OSPI0_D6_C, UART0_CTS_B, Reserved, SPI1_SS2_B, UT7_T0_B, SD_D6_D, Reserved
  P6_7 location=A9 register=P6_7 offset=0xDC muxModes=GPIO6_7, OSPI0_D7_C, UART0_RTS_B, PDM_C2_A, SPI1_SS3_B, UT7_T1_B, SD_D7_D, Reserved
  P7_0 location=B8 register=P7_0 offset=0xE0 muxModes=GPIO7_0, Reserved, Reserved, SPI0_MISO_C, I2C0_SDA_C, Reserved, SD_CMD_A, CAN_RXD_A
  P7_1 location=B3 register=P7_1 offset=0xE4 muxModes=GPIO7_1, Reserved, Reserved, SPI0_MOSI_C, I2C0_SCL_C, Reserved, SD_CLK_A, CAN_TXD_A
  P7_2 location=D1 register=P7_2 offset=0xE8 muxModes=GPIO7_2, Reserved, UART3_CTS_B, CMP1_OUT_A, SPI0_SCLK_C, I2C1_SDA_C, Reserved, SD_RST_A
  P7_3 location=A8 register=P7_3 offset=0xEC muxModes=GPIO7_3, Reserved, UART3_RTS_B, CMP0_OUT_A, SPI0_SS0_C, I2C1_SCL_C, Reserved, CAN_STBY_A
  P7_4 location=T1 register=P7_4 offset=0xF0 muxModes=GPIO7_4, Reserved, LPUART_CTS_A, LPPDM_C2_A, LPSPI_MISO_A, LPI2C_SCL_A, Reserved
  P7_5 location=T2 register=P7_5 offset=0xF4 muxModes=GPIO7_5, Reserved, LPUART_RTS_A, Reserved, LPPDM_D2_A, LPSPI_MOSI_A, LPI2C_SDA_A, Reserved
  P7_6 location=U3 register=P7_6 offset=0xF8 muxModes=GPIO7_6, Reserved, LPUART_RX_A, Reserved, LPPDM_C3_A, LPSPI_SCLK_A, I3C_SDA_D, Reserved
  P7_7 location=U1 register=P7_7 offset=0xFC muxModes=GPIO7_7, Reserved, LPUART_TX_A, Reserved, LPPDM_D3_A, LPSPI_SS_A, I3C_SCL_D, Reserved
  P8_0 location=B7 register=P8_0 offset=0x100 muxModes=GPIO8_0, Reserved, AUDIO_CLK_A, FAULT0_B, LPCAM_D0_A, SD_D0_C, CDC_D0_A, Reserved
  P8_1 location=C2 register=P8_1 offset=0x104 muxModes=GPIO8_1, Reserved, FAULT1_B, LPCAM_D1_A, SD_D1_C, CDC_D1_A, Reserved
  P8_2 location=C3 register=P8_2 offset=0x108 muxModes=GPIO8_2, Reserved, SPI0_SS3_B, FAULT2_B, LPCAM_D2_A, SD_D2_C, CDC_D2_A, Reserved
  P8_3 location=A7 register=P8_3 offset=0x10C muxModes=GPIO8_3, Reserved, SPI1_MISO_B, FAULT3_B, LPCAM_D3_A, SD_D3_C, CDC_D3_A, Reserved
  P8_4 location=B4 register=P8_4 offset=0x110 muxModes=GPIO8_4, Reserved, SPI1_MOSI_B, QEC0_X_B, LPCAM_D4_A, SD_D4_C, CDC_D4_A, Reserved
  P8_5 location=H1 register=P8_5 offset=0x114 muxModes=GPIO8_5, Reserved, SPI1_SCLK_B, QEC0_Y_B, LPCAM_D5_A, SD_D5_C, CDC_D5_A, Reserved
  P8_6 location=J2 register=P8_6 offset=0x118 muxModes=GPIO8_6, Reserved, Reserved, QEC0_Z_B, LPCAM_D6_A, SD_D6_C, CDC_D6_A, Reserved
  P8_7 location=J1 register=P8_7 offset=0x11C muxModes=GPIO8_7, Reserved, Reserved, QEC1_X_B, LPCAM_D7_A, SD_D7_C, CDC_D7_A, Reserved
  P9_0 location=K2 register=P9_0 offset=0x120 muxModes=GPIO9_0, Reserved, Reserved, QEC1_Y_B, SD_CMD_C, CDC_D8_A, Reserved
  P9_1 location=K1 register=P9_1 offset=0x124 muxModes=GPIO9_1, LPUART_RX_B, Reserved, QEC1_Z_B, SD_CLK_C, CDC_D9_A, Reserved
  P9_2 location=G5 register=P9_2 offset=0x128 muxModes=GPIO9_2, LPUART_TX_B, Reserved, SPI2_MISO_B, QEC2_X_B, SD_RST_C, CDC_D10_A, Reserved
  P9_3 location=H5 register=P9_3 offset=0x12C muxModes=GPIO9_3, Reserved, Reserved, Reserved, SPI2_MOSI_B, QEC2_Y_B, CDC_D11_A, Reserved
  P9_4 location=J5 register=P9_4 offset=0x130 muxModes=GPIO9_4, Reserved, Reserved, SPI2_SCLK_B, I2C3_SDA_C, QEC2_Z_B, CDC_D12_A, Reserved
  P9_5 location=L1 register=P9_5 offset=0x134 muxModes=GPIO9_5, Reserved, Reserved, SPI2_SS0_B, I2C3_SCL_C, QEC3_X_B, CDC_D13_A, Reserved
  P9_6 location=K5 register=P9_6 offset=0x138 muxModes=GPIO9_6, Reserved, AUDIO_CLK_B, SPI2_SS1_B, I2C3_SDA_B, QEC3_Y_B, CDC_D14_A, Reserved
  P9_7 location=L5 register=P9_7 offset=0x13C muxModes=GPIO9_7, Reserved, Reserved, SPI2_SS2_B, I2C3_SCL_B, QEC3_Z_B, CDC_D15_A, Reserved
  P10_0 location=M2 register=P10_0 offset=0x140 muxModes=GPIO10_0, Reserved, Reserved, SPI2_SS3_B, UT0_T0_C, LPCAM_HSYNC_A, CDC_D16_A, Reserved
  P10_1 location=M1 register=P10_1 offset=0x144 muxModes=GPIO10_1, Reserved, Reserved, LPI2S_SDI_B, UT0_T1_C, LPCAM_VSYNC_A, CDC_D17_A, Reserved
  P10_2 location=N1 register=P10_2 offset=0x148 muxModes=GPIO10_2, Reserved, Reserved, LPI2S_SDO_B, UT1_T0_C, LPCAM_PCLK_A, CDC_D18_A, Reserved
  P10_3 location=N2 register=P10_3 offset=0x14C muxModes=GPIO10_3, Reserved, Reserved, LPI2S_SCLK_B, UT1_T1_C, LPCAM_XVCLK_A, CDC_D19_A, Reserved
  P10_4 location=M5 register=P10_4 offset=0x150 muxModes=GPIO10_4, Reserved, Reserved, LPI2S_WS_B, I2C0_SDA_D, UT2_T0_C, Reserved, CDC_D20_A
  P10_5 location=N5 register=P10_5 offset=0x154 muxModes=GPIO10_5, Reserved, Reserved, SPI3_MISO_B, I2C0_SCL_D, UT2_T1_C, Reserved, CDC_D21_A
  P10_6 location=P5 register=P10_6 offset=0x158 muxModes=GPIO10_6, Reserved, Reserved, SPI3_MOSI_B, I2C1_SDA_D, UT3_T0_C, Reserved, CDC_D22_A
  P10_7 location=P1 register=P10_7 offset=0x15C muxModes=GPIO10_7, Reserved, Reserved, SPI3_SCLK_B, I2C1_SCL_D, UT3_T1_C, CDC_D23_A, Reserved
  P11_0 location=P2 register=P11_0 offset=0x160 muxModes=GPIO11_0, Reserved, Reserved, Reserved, SPI3_SS0_B, UT4_T0_C, Reserved, CDC_D0_B
  P11_1 location=R1 register=P11_1 offset=0x164 muxModes=GPIO11_1, Reserved, Reserved, SPI3_SS1_B, UT4_T1_C, Reserved, CDC_D1_B
  P11_2 location=R2 register=P11_2 offset=0x168 muxModes=GPIO11_2, Reserved, Reserved, LPPDM_C2_B, SPI3_SS2_B, UT5_T0_C, Reserved, CDC_D2_B
  P11_3 location=R5 register=P11_3 offset=0x16C muxModes=GPIO11_3, Reserved, UART5_RX_B, LPPDM_C3_B, SPI3_SS3_B, UT5_T1_C, Reserved, CDC_D3_B
  P11_4 location=K8 register=P11_4 offset=0x170 muxModes=GPIO11_4, Reserved, UART5_TX_B, PDM_C2_B, LPSPI_MISO_B, UT6_T0_C, Reserved, CDC_D4_B
  P11_5 location=J9 register=P11_5 offset=0x174 muxModes=GPIO11_5, Reserved, Reserved, PDM_C3_B, LPSPI_MOSI_B, UT6_T1_C, Reserved, CDC_D5_B
  P11_6 location=R6 register=P11_6 offset=0x178 muxModes=GPIO11_6, Reserved, Reserved, LPPDM_D2_B, LPSPI_SCLK_B, UT7_T0_C, Reserved, CDC_D6_B
  P11_7 location=L9 register=P11_7 offset=0x17C muxModes=GPIO11_7, Reserved, UART5_DE_B, LPPDM_D3_B, LPSPI_SS_B, UT7_T1_C, Reserved, CDC_D7_B
  P12_0 location=F19 register=P12_0 offset=0x180 muxModes=GPIO12_0, OSPI0_SCLK_C, AUDIO_CLK_C, I2S1_SDI_B, Reserved, CDC_D8_B
  P12_1 location=E18 register=P12_1 offset=0x184 muxModes=GPIO12_1, OSPI0_SCLKN_C, UART4_RX_B, I2S1_SDO_B, Reserved, CDC_D9_B
  P12_2 location=E15 register=P12_2 offset=0x188 muxModes=GPIO12_2, OSPI0_RXDS_C, UART4_TX_B, I2S1_SCLK_B, Reserved, CDC_D10_B
  P12_3 location=D18 register=P12_3 offset=0x18C muxModes=GPIO12_3, OSPI0_SS0_C, UART4_DE_B, I2S1_WS_B, Reserved, CDC_D11_B
  P12_4 location=F5 register=P12_4 offset=0x190 muxModes=GPIO12_4, OSPI0_SS1_C, SPI3_MISO_A, Reserved, CAN_RXD_C, CDC_D12_B
  P12_5 location=A10 register=P12_5 offset=0x194 muxModes=GPIO12_5, Reserved, SPI3_MOSI_A, Reserved, CAN_TXD_C, CDC_D13_B
  P12_6 location=E5 register=P12_6 offset=0x198 muxModes=GPIO12_6, Reserved, SPI3_SCLK_A, Reserved, CAN_STBY_C, CDC_D14_B
  P12_7 location=D2 register=P12_7 offset=0x19C muxModes=GPIO12_7, Reserved, Reserved, SPI3_SS0_A, Reserved, CDC_D15_B
  P13_0 location=G18 register=P13_0 offset=0x1A0 muxModes=GPIO13_0, Reserved, Reserved, SPI3_SS1_A, QEC0_X_C, SD_D0_B, CDC_D16_B
  P13_1 location=G15 register=P13_1 offset=0x1A4 muxModes=GPIO13_1, Reserved, SPI3_SS2_A, QEC0_Y_C, SD_D1_B, CDC_D17_B
  P13_2 location=F15 register=P13_2 offset=0x1A8 muxModes=GPIO13_2, Reserved, SPI3_SS3_A, QEC0_Z_C, SD_D2_B, CDC_D18_B
  P13_3 location=E13 register=P13_3 offset=0x1AC muxModes=GPIO13_3, Reserved, SPI2_SS3_A, QEC1_X_C, SD_D3_B, CDC_D19_B
  P13_4 location=E14 register=P13_4 offset=0x1B0 muxModes=GPIO13_4, Reserved, LPI2S_SDI_C, QEC1_Y_C, SD_D4_B, CDC_D20_B
  P13_5 location=A17 register=P13_5 offset=0x1B4 muxModes=GPIO13_5, Reserved, LPI2S_SDO_C, QEC1_Z_C, SD_D5_B, CDC_D21_B
  P13_6 location=B15 register=P13_6 offset=0x1B8 muxModes=GPIO13_6, Reserved, LPI2S_SCLK_C, QEC2_X_C, SD_D6_B, CDC_D22_B
  P13_7 location=A15 register=P13_7 offset=0x1BC muxModes=GPIO13_7, Reserved, LPI2S_WS_C, QEC2_Y_C, SD_D7_B, CDC_D23_B
  P14_0 location=B9 register=P14_0 offset=0x1C0 muxModes=GPIO14_0, Reserved, Reserved, QEC2_Z_C, SD_CMD_B
  P14_1 location=H2 register=P14_1 offset=0x1C4 muxModes=GPIO14_1, Reserved, Reserved, Reserved, QEC3_X_C, SD_CLK_B
  P14_2 location=G1 register=P14_2 offset=0x1C8 muxModes=GPIO14_2, Reserved, Reserved, Reserved, QEC3_Y_C, SD_RST_B
  P14_3 location=R7 register=P14_3 offset=0x1CC muxModes=GPIO14_3, Reserved, Reserved, Reserved, QEC3_Z_C
  P14_4 location=R8 register=P14_4 offset=0x1D0 muxModes=GPIO14_4, Reserved, SPI1_MISO_C, FAULT0_C
  P14_5 location=L11 register=P14_5 offset=0x1D4 muxModes=GPIO14_5, Reserved, SPI1_MOSI_C, FAULT1_C
  P14_6 location=K12 register=P14_6 offset=0x1D8 muxModes=GPIO14_6, CMP1_OUT_B, SPI1_SCLK_C, FAULT2_C
  P14_7 location=L12 register=P14_7 offset=0x1DC muxModes=GPIO14_7, CMP0_OUT_B, SPI1_SS0_C, FAULT3_C
  P15_0 location=V2 register=LPGPIO_CTRL_0 offset=0x0 muxModes=GPIOV_0, LPTMR0_CLK_IO
  P15_1 location=W2 register=LPGPIO_CTRL_1 offset=0x4 muxModes=GPIOV_1, LPTMR1_CLK_IO
  P15_2 location=U2 register=LPGPIO_CTRL_2 offset=0x8 muxModes=GPIOV_2, Reserved
  P15_3 location=V1 register=LPGPIO_CTRL_3 offset=0xC muxModes=GPIOV_3, Reserved
  P15_4 location=V3 register=LPGPIO_CTRL_4 offset=0x10 muxModes=GPIOV_4
  P15_5 location=W4 register=LPGPIO_CTRL_5 offset=0x14 muxModes=GPIOV_5
  P15_6 location=V4 register=LPGPIO_CTRL_6 offset=0x18 muxModes=GPIOV_6
  P15_7 location=W5 register=LPGPIO_CTRL_7 offset=0x1C muxModes=GPIOV_7
  SEUART_RX location=A14 register=NA offset=NA muxModes=SEUART_RX
  SEUART_TX location=A13 register=NA offset=NA muxModes=SEUART_TX
  VSS location=J11 register=NA offset=NA muxModes=VSS
  N.C. location=M18 register=NA offset=NA muxModes=N.C.
  N.C. location=J8 register=NA offset=NA muxModes=N.C.
  N.C. location=C1 register=NA offset=NA muxModes=N.C.
  N.C. location=B1 register=NA offset=NA muxModes=N.C.
  VDD_PLL_0V8 location=A1 register=NA offset=NA muxModes=VDD_PLL_0V8
  NSRST location=J12 register=NA offset=NA muxModes=NSRST
  POR_N location=U18 register=NA offset=NA muxModes=POR_N
  HFXO_P location=A4 register=NA offset=NA muxModes=HFXO_P
  HFXO_N location=A3 register=NA offset=NA muxModes=HFXO_N
  LFXO_P location=W17 register=NA offset=NA muxModes=LFXO_P
  LFXO_N location=V17 register=NA offset=NA muxModes=LFXO_N
  VREF_P location=N18 register=NA offset=NA muxModes=VREF_P
  VDD_MAIN location=P19 register=NA offset=NA muxModes=VDD_MAIN
  VDD_BATT location=T18 register=NA offset=NA muxModes=VDD_BATT
  VDD_BUCK location=R18 register=NA offset=NA muxModes=VDD_BUCK
  VDD_IO_FLEX location=W1 register=NA offset=NA muxModes=VDD_IO_FLEX
  VDD_IO_1V8 location=A5 register=NA offset=NA muxModes=VDD_IO_1V8
  VDD_IO_1V8 location=D19 register=NA offset=NA muxModes=VDD_IO_1V8
  VDD_IO_1V8 location=W3 register=NA offset=NA muxModes=VDD_IO_1V8
  VDD_CORE_0V8 location=B5 register=NA offset=NA muxModes=VDD_CORE_0V8
  VDD_CORE_0V8 location=E1 register=NA offset=NA muxModes=VDD_CORE_0V8
  VDD_CORE_0V8 location=E19 register=NA offset=NA muxModes=VDD_CORE_0V8
  VDD_CORE_0V8 location=V6 register=NA offset=NA muxModes=VDD_CORE_0V8
  VREG_MIPI_0V8 location=W13 register=NA offset=NA muxModes=VREG_MIPI_0V8
  VDD_MIPI_1V8 location=W12 register=NA offset=NA muxModes=VDD_MIPI_1V8
  VDD_USB_3V3 location=W8 register=NA offset=NA muxModes=VDD_USB_3V3
  VDD_SX_0V8 location=A2 register=NA offset=NA muxModes=VDD_SX_0V8
  VSS location=B2 register=NA offset=NA muxModes=VSS
  VSS location=V12 register=NA offset=NA muxModes=VSS
  VSS location=K9 register=NA offset=NA muxModes=VSS
  VSS location=K11 register=NA offset=NA muxModes=VSS
  VSS location=K10 register=NA offset=NA muxModes=VSS
  VSS location=C18 register=NA offset=NA muxModes=VSS
  VSS location=J10 register=NA offset=NA muxModes=VSS
  VSS location=L2 register=NA offset=NA muxModes=VSS
  VSS location=L10 register=NA offset=NA muxModes=VSS
  VSS_BUCK location=V19 register=NA offset=NA muxModes=VSS_BUCK
  VSS_ANA location=P18 register=NA offset=NA muxModes=VSS_ANA
  VREG_CORE_0V8 location=W18 register=NA offset=NA muxModes=VREG_CORE_0V8
  VREG_AON location=U17 register=NA offset=NA muxModes=VREG_AON
  VREG_LP_1V8 location=W19 register=NA offset=NA muxModes=VREG_LP_1V8
  VREG_DIG_1V8 location=U19 register=NA offset=NA muxModes=VREG_DIG_1V8
  VREG_AUX_1V8 location=V18 register=NA offset=NA muxModes=VREG_AUX_1V8
  VREG_MIPI_1V8 location=N19 register=NA offset=NA muxModes=VREG_MIPI_1V8
  VSW location=T19 register=NA offset=NA muxModes=VSW
  USB_REXT location=V8 register=NA offset=NA muxModes=USB_REXT
  USB_DP location=W7 register=NA offset=NA muxModes=USB_DP
  USB_DM location=V7 register=NA offset=NA muxModes=USB_DM
  USB_VBUS location=W6 register=NA offset=NA muxModes=USB_VBUS
  USB_IO_ID location=R9 register=NA offset=NA muxModes=USB_IO_ID
  N.C. location=V13 register=NA offset=NA muxModes=Reserved
  N.C. location=W14 register=NA offset=NA muxModes=Reserved
  N.C. location=V14 register=NA offset=NA muxModes=Reserved
  N.C. location=W15 register=NA offset=NA muxModes=Reserved
  N.C. location=V15 register=NA offset=NA muxModes=Reserved
  N.C. location=W16 register=NA offset=NA muxModes=Reserved
  N.C. location=V16 register=NA offset=NA muxModes=Reserved
  MIPIDSI_0_P location=W11 register=NA offset=NA muxModes=MIPIDSI_0_P
  MIPIDSI_0_N location=V11 register=NA offset=NA muxModes=MIPIDSI_0_N
  MIPIDSI_1_P location=W9 register=NA offset=NA muxModes=MIPIDSI_1_P
  MIPIDSI_1_N location=V9 register=NA offset=NA muxModes=MIPIDSI_1_N
  MIPIDSI_C_P location=W10 register=NA offset=NA muxModes=MIPIDSI_C_P
  MIPIDSI_C_N location=V10 register=NA offset=NA muxModes=MIPIDSI_C_N
