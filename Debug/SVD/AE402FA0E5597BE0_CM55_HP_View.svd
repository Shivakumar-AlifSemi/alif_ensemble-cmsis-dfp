# AE402FA0E5597BE0_CM55_HP_View register map
Vendor: Alif Semiconductor; Series: E4; File version: 1.0
CPU: CM55 r1p0, selectable endian, MPU, FPU, double-precision FPU, DSP, VTOR, 8 interrupt priority bits, 1 SAU regions

## Further device data (continued)
irqs:
  FCTLR
    FW_IRQ cpuLine=IRQRTR_SII_0 cpuLineNum=0 type=Level irqDesc=FCTLR interrupt request
  HWSEM
    HWSEM_IRQ{n} cpuLine=M55HE_IRQS_{n+105},M55HP_IRQS_{n+105},IRQRTR_SII_{n+41} cpuLineNum={n+105},{n+105},{n+41} type=Level irqDesc=HWSEM interrupt request {n} (n=0..15)
  DMA0_SEC
    DMA0_IRQ{n} cpuLine=IRQRTR_SII_{n+235},M55HE_IRQS_{n+299},M55HP_IRQS_{n+299} cpuLineNum={n+235},{n+299},{n+299} type=Level irqDesc=Interrupt request {n}. One per DMA request interface (32 in total). (n=0..31)
    DMA0_IRQ_ABORT cpuLine=IRQRTR_SII_267,M55HE_IRQS_331,M55HP_IRQS_331 cpuLineNum=267,331,331 type=Level irqDesc=DMAC aborted execution of a program thread.
  DMA0_NS
    DMA0_IRQ{n} cpuLine=IRQRTR_SII_{n+235},M55HE_IRQS_{n+299},M55HP_IRQS_{n+299} cpuLineNum={n+235},{n+299},{n+299} type=Level irqDesc=Interrupt request {n}. One per DMA request interface (32 in total). (n=0..31)
    DMA0_IRQ_ABORT cpuLine=IRQRTR_SII_267,M55HE_IRQS_331,M55HP_IRQS_331 cpuLineNum=267,331,331 type=Level irqDesc=DMAC aborted execution of a program thread.
  GPIO0
    GPIO0_IRQ{n} cpuLine=IRQRTR_SII_{n+115},M55HE_IRQS_{n+179},M55HP_IRQS_{n+179} cpuLineNum={n+115},{n+179},{n+179} type=Level irqDesc=GPIO0 interrupt request {n} (n=0..7)
  GPIO1
    GPIO1_IRQ{n} cpuLine=IRQRTR_SII_{n+123},M55HE_IRQS_{n+187},M55HP_IRQS_{n+187} cpuLineNum={n+123},{n+187},{n+187} type=Level irqDesc=GPIO1 interrupt request {n} (n=0..7)
  GPIO2
    GPIO2_IRQ{n} cpuLine=IRQRTR_SII_{n+131},M55HE_IRQS_{n+195},M55HP_IRQS_{n+195} cpuLineNum={n+131},{n+195},{n+195} type=Level irqDesc=GPIO2 interrupt request {n} (n=0..7)
  GPIO3
    GPIO3_IRQ{n} cpuLine=IRQRTR_SII_{n+139},M55HE_IRQS_{n+203},M55HP_IRQS_{n+203} cpuLineNum={n+139},{n+203},{n+203} type=Level irqDesc=GPIO3 interrupt request {n} (n=0..7)
  GPIO4
    GPIO4_IRQ{n} cpuLine=IRQRTR_SII_{n+147},M55HE_IRQS_{n+211},M55HP_IRQS_{n+211} cpuLineNum={n+147},{n+211},{n+211} type=Level irqDesc=GPIO4 interrupt request {n} (n=0..7)
  GPIO5
    GPIO5_IRQ{n} cpuLine=IRQRTR_SII_{n+155},M55HE_IRQS_{n+219},M55HP_IRQS_{n+219} cpuLineNum={n+155},{n+219},{n+219} type=Level irqDesc=GPIO5 interrupt request {n} (n=0..7)
  GPIO6
    GPIO6_IRQ{n} cpuLine=IRQRTR_SII_{n+163},M55HE_IRQS_{n+227},M55HP_IRQS_{n+227} cpuLineNum={n+163},{n+227},{n+227} type=Level irqDesc=GPIO6 interrupt request {n} (n=0..7)
  GPIO7
    GPIO7_IRQ{n} cpuLine=IRQRTR_SII_{n+171},M55HE_IRQS_{n+235},M55HP_IRQS_{n+235} cpuLineNum={n+171},{n+235},{n+235} type=Level irqDesc=GPIO7 interrupt request {n} (n=0..7)
  GPIO8
    GPIO8_IRQ{n} cpuLine=IRQRTR_SII_{n+179},M55HE_IRQS_{n+243},M55HP_IRQS_{n+243} cpuLineNum={n+179},{n+243},{n+243} type=Level irqDesc=GPIO8 interrupt request {n} (n=0..7)
  GPIO9
    GPIO9_IRQ{n} cpuLine=IRQRTR_SII_{n+187},M55HE_IRQS_{n+251},M55HP_IRQS_{n+251} cpuLineNum={n+187},{n+251},{n+251} type=Level irqDesc=GPIO9 interrupt request {n} (n=0..7)
  GPIO10
    GPIO10_IRQ{n} cpuLine=IRQRTR_SII_{n+195},M55HE_IRQS_{n+259},M55HP_IRQS_{n+259} cpuLineNum={n+195},{n+259},{n+259} type=Level irqDesc=GPIO10 interrupt request {n} (n=0..7)
  GPIO11
    GPIO11_IRQ{n} cpuLine=IRQRTR_SII_{n+203},M55HE_IRQS_{n+267},M55HP_IRQS_{n+267} cpuLineNum={n+203},{n+267},{n+267} type=Level irqDesc=GPIO11 interrupt request {n} (n=0..7)
  GPIO12
    GPIO12_IRQ{n} cpuLine=IRQRTR_SII_{n+211},M55HE_IRQS_{n+275},M55HP_IRQS_{n+275} cpuLineNum={n+211},{n+275},{n+275} type=Level irqDesc=GPIO12 interrupt request {n} (n=0..7)
  GPIO13
    GPIO13_IRQ{n} cpuLine=IRQRTR_SII_{n+219},M55HE_IRQS_{n+283},M55HP_IRQS_{n+283} cpuLineNum={n+219},{n+283},{n+283} type=Level irqDesc=GPIO13 interrupt request {n} (n=0..7)
  GPIO14
    GPIO14_IRQ{n} cpuLine=IRQRTR_SII_{n+227},M55HE_IRQS_{n+291},M55HP_IRQS_{n+291} cpuLineNum={n+227},{n+291},{n+291} type=Level irqDesc=GPIO14 interrupt request {n} (n=0..7)
  GPIO16
    GPIO16_COMB_IRQ cpuLine=M55HE_IRQS_52 cpuLineNum=52 type=Level irqDesc=GPIO16 combined interrupt request
    GPIO16_IRQ cpuLine=IRQRTR_SII_412,M55HE_IRQS_476,M55HP_IRQS_476 cpuLineNum=412,476,476 type=Level
  GPIO17
    GPIO17_COMB_IRQ cpuLine=M55HE_IRQS_53 cpuLineNum=53 type=Level irqDesc=GPIO17 combined interrupt request
    GPIO17_IRQ cpuLine=IRQRTR_SII_413,M55HE_IRQS_477,M55HP_IRQS_477 cpuLineNum=413,477,477 type=Level
  LPRTC0
    LPRTC0_IRQ cpuLine=IRQRTR_SII_286,M55HE_IRQS_350,M55HP_IRQS_350,M55HE_IRQS_58,M55HP_IRQS_58 cpuLineNum=286,350,350,58,58 type=Level irqDesc=LPRTC0 interrupt request
  LPTIMER0
    LPTIMER0_IRQ cpuLine=IRQRTR_SII_282,M55HE_IRQS_346,M55HP_IRQS_346,M55HE_IRQS_60,M55HP_IRQS_60 cpuLineNum=282,346,346,60,60 type=Level irqDesc=LPTIMER0 interrupt request
  LPTIMER1
    LPTIMER1_IRQ cpuLine=IRQRTR_SII_283,M55HE_IRQS_347,M55HP_IRQS_347,M55HE_IRQS_61,M55HP_IRQS_61 cpuLineNum=283,347,347,61,61 type=Level irqDesc=LPTIMER1 interrupt request
  LPTIMER2
    LPTIMER2_IRQ cpuLine=IRQRTR_SII_284,M55HE_IRQS_348,M55HP_IRQS_348,M55HE_IRQS_62,M55HP_IRQS_62 cpuLineNum=284,348,348,62,62 type=Level irqDesc=LPTIMER2 interrupt request
  LPTIMER3
    LPTIMER3_IRQ cpuLine=IRQRTR_SII_285,M55HE_IRQS_349,M55HP_IRQS_349,M55HE_IRQS_63,M55HP_IRQS_63 cpuLineNum=285,349,349,63,63 type=Level irqDesc=LPTIMER3 interrupt request
  LPGPIO
    LPGPIO_COMB_IRQ cpuLine=M55HE_IRQS_57,M55HP_IRQS_57 cpuLineNum=57,57 type=Level irqDesc=LPGPIO/LPGPIO_FAST combined interrupt request
    LPGPIO_IRQ{n} cpuLine=IRQRTR_SII_{n+107},M55HE_IRQS_{n+171},M55HP_IRQS_{n+171} cpuLineNum={n+107},{n+171},{n+171} type=Level irqDesc=LPGPIO/LPGPIO_FAST interrupt request {n} (n=0..7)
  LPCMP
    LPCMP_IRQ cpuLine=M55HE_IRQS_56,M55HP_IRQS_56 cpuLineNum=56,56 type=Level irqDesc=Comparator output changed
  LPSPI0
    LPSPI0_IRQ cpuLine=IRQRTR_SII_414,M55HE_IRQS_46,M55HE_IRQS_478,M55HP_IRQS_478 cpuLineNum=414,46,478,478 type=Level irqDesc=LPSPI00/1 interrupt request
  LPI2S
    LPI2S_IRQ cpuLine=IRQRTR_SII_411,M55HE_IRQS_475,M55HP_IRQS_475,M55HE_IRQS_48 cpuLineNum=411,475,475,48 type=Level irqDesc=LPI2S interrupt request
  LPPDM
    LPPDM_IRQ cpuLine=IRQRTR_SII_415,M55HE_IRQS_479,M55HP_IRQS_479,M55HE_IRQS_49 cpuLineNum=415,479,479,49 type=Level irqDesc=LPPDM combined (OR-ed) interrupt of following requests : Warning interrupt request (WARN_IRQ) Error interrupt request (ERROR_IRQ) Audio peak detection interrupt request (AUDIO_DET_IRQ) Upon interrupt assertion, the LPPDM interrupt status registers should be read to identify the source of the interrupt.
  LPUART
    LPUART_IRQ cpuLine=IRQRTR_SII_295,M55HE_IRQS_359,M55HP_IRQS_359,M55HE_IRQS_45 cpuLineNum=295,359,359,45 type=Level irqDesc=LPUART interrupt request
  LPI2C0
    LPI2C0_IRQ cpuLine=M55HE_IRQS_47 cpuLineNum=47 type=Level irqDesc=LPI2C0 interrupt request
  LPI2C1
    LPI2C1_IRQ cpuLine=IRQRTR_SII_410,M55HE_IRQS_474,M55HP_IRQS_474,M55HE_IRQS_51 cpuLineNum=410,474,474,51 type=Level irqDesc=LPI2C1 interrupt request
  LPI3C
    LPI3C_IRQ cpuLine=IRQRTR_SII_409,M55HE_IRQS_473,M55HP_IRQS_473,M55HE_IRQS_50 cpuLineNum=409,473,473,50 type=Level irqDesc=LPI3C interrupt request
  LPCPI
    LPCAM_IRQ cpuLine=M55HE_IRQS_54 cpuLineNum=54 type=Edge irqDesc=LPCPI interrupt
  DSI
    DSI_IRQ cpuLine=IRQRTR_SII_279,M55HE_IRQS_343,M55HP_IRQS_343 cpuLineNum=279,343,343 type=Level irqDesc=DSI error interrupt
  CDC
    CDC_BUS_ERROR0_IRQ cpuLine=IRQRTR_SII_275,M55HE_IRQS_339,M55HP_IRQS_339 cpuLineNum=275,339,339 type=Level irqDesc=CDC bus error interrupt
    CDC_FIFO_UNDERRUN0_IRQ cpuLine=IRQRTR_SII_273,M55HE_IRQS_337,M55HP_IRQS_337 cpuLineNum=273,337,337 type=Level irqDesc=CDC layer FIFO underrun interrupt
    CDC_FIFO_WARNING0_IRQ cpuLine=IRQRTR_SII_271,M55HE_IRQS_335,M55HP_IRQS_335 cpuLineNum=271,335,335 type=Level irqDesc=CDC FIFO underrun warning interrupt
    CDC_REG_RELOAD0_IRQ cpuLine=IRQRTR_SII_277,M55HE_IRQS_341,M55HP_IRQS_341 cpuLineNum=277,341,341 type=Level irqDesc=CDC register reload interrupt
    CDC_SCANLINE0_IRQ cpuLine=IRQRTR_SII_269,M55HE_IRQS_333,M55HP_IRQS_333 cpuLineNum=269,333,333 type=Level irqDesc=CDC line interrupt
  CSI
    CSI_IRQ cpuLine=IRQRTR_SII_280,M55HE_IRQS_344,M55HP_IRQS_344 cpuLineNum=280,344,344 type=Edge irqDesc=CSI interrupt
  CSI2-DSI_DPHY
    CSI_IRQ cpuLine=IRQRTR_SII_280,M55HE_IRQS_344,M55HP_IRQS_344 cpuLineNum=280,344,344 type=Edge irqDesc=CSI interrupt
  CPI
    CAM_IRQ cpuLine=IRQRTR_SII_281,M55HE_IRQS_345,M55HP_IRQS_345 cpuLineNum=281,345,345 type=Edge irqDesc=CPI interrupt
  GPU2D
    GPU2D_IRQ cpuLine=IRQRTR_SII_268,M55HE_IRQS_332,M55HP_IRQS_332 cpuLineNum=268,332,332 type=Level irqDesc=GPU2D aggregated interrupt request
  NPU-HG
    NPU_HG_IRQ cpuLine=IRQRTR_SII_302,M55HE_IRQS_366,M55HP_IRQS_366 cpuLineNum=302,366,366 type=Level irqDesc=NPU-HG interrupt
  JPEG
    JPEG_XINT_ABN_IRQ cpuLine=IRQRTR_SII_298,M55HE_IRQS_362,M55HP_IRQS_362 cpuLineNum=298,362,362 type=Level irqDesc=JPEG ABN interrupt request
    JPEG_XINT_IDLE_IRQ cpuLine=IRQRTR_SII_299,M55HE_IRQS_363,M55HP_IRQS_363 cpuLineNum=299,363,363 type=Level
    JPEG_XINT_IRQ cpuLine=IRQRTR_SII_296,M55HE_IRQS_360,M55HP_IRQS_360 cpuLineNum=296,360,360 type=Level irqDesc=JPEG interrupt request
    JPEG_XINT_NORM_IRQ cpuLine=IRQRTR_SII_297,M55HE_IRQS_361,M55HP_IRQS_361 cpuLineNum=297,361,361 type=Level irqDesc=JPEG NORM interrupt request
  ISP
    ISP_IRQ cpuLine=IRQRTR_SII_303,M55HE_IRQS_367,M55HP_IRQS_367 cpuLineNum=303,367,367 type=Level irqDesc=ISP interrupt request
    ISP_MI_IRQ cpuLine=IRQRTR_SII_304,M55HE_IRQS_368,M55HP_IRQS_368 cpuLineNum=304,368,368 type=Level irqDesc=ISP MI interrupt request
  ADC120
    ADC120_CMPA_IRQ cpuLine=M55HE_IRQS_157,M55HP_IRQS_157,IRQRTR_SII_93 cpuLineNum=157,157,93 type=Level irqDesc=Comparator A interrupt
    ADC120_CMPB_IRQ cpuLine=M55HE_IRQS_160,M55HP_IRQS_160,IRQRTR_SII_96 cpuLineNum=160,160,96 type=Level irqDesc=Comparator B interrupt
    ADC120_DONE0_IRQ cpuLine=M55HE_IRQS_151,M55HP_IRQS_151,IRQRTR_SII_87 cpuLineNum=151,151,87 type=Level irqDesc=Averaged sample ready
    ADC120_DONE1_IRQ cpuLine=M55HE_IRQS_154,M55HP_IRQS_154,IRQRTR_SII_90 cpuLineNum=154,154,90 type=Level irqDesc=All samples taken
  ADC121
    ADC121_CMPA_IRQ cpuLine=M55HE_IRQS_158,M55HP_IRQS_158,IRQRTR_SII_94 cpuLineNum=158,158,94 type=Level irqDesc=Comparator A interrupt
    ADC121_CMPB_IRQ cpuLine=M55HE_IRQS_161,M55HP_IRQS_161,IRQRTR_SII_97 cpuLineNum=161,161,97 type=Level irqDesc=Comparator B interrupt
    ADC121_DONE0_IRQ cpuLine=M55HE_IRQS_152,M55HP_IRQS_152,IRQRTR_SII_88 cpuLineNum=152,152,88 type=Level irqDesc=Averaged sample ready
    ADC121_DONE1_IRQ cpuLine=M55HE_IRQS_155,M55HP_IRQS_155,IRQRTR_SII_91 cpuLineNum=155,155,91 type=Level irqDesc=All samples taken
  ADC122
    ADC122_CMPA_IRQ cpuLine=M55HE_IRQS_159,M55HP_IRQS_159,IRQRTR_SII_95 cpuLineNum=159,159,95 type=Level irqDesc=Comparator A interrupt
    ADC122_CMPB_IRQ cpuLine=M55HE_IRQS_162,M55HP_IRQS_162,IRQRTR_SII_98 cpuLineNum=162,162,98 type=Level irqDesc=Comparator B interrupt
    ADC122_DONE0_IRQ cpuLine=M55HE_IRQS_153,M55HP_IRQS_153,IRQRTR_SII_89 cpuLineNum=153,153,89 type=Level irqDesc=Averaged sample ready
    ADC122_DONE1_IRQ cpuLine=M55HE_IRQS_156,M55HP_IRQS_156,IRQRTR_SII_92 cpuLineNum=156,156,92 type=Level irqDesc=All samples taken
  ADC24
    ADC24_CMPA_IRQ cpuLine=IRQRTR_SII_101,M55HE_IRQS_165,M55HP_IRQS_165 cpuLineNum=101,165,165 type=Level irqDesc=Comparator A interrupt
    ADC24_CMPB_IRQ cpuLine=IRQRTR_SII_102,M55HE_IRQS_166,M55HP_IRQS_166 cpuLineNum=102,166,166 type=Level irqDesc=Comparator B interrupt
    ADC24_DONE0_IRQ cpuLine=M55HE_IRQS_163,M55HP_IRQS_163,IRQRTR_SII_99 cpuLineNum=163,163,99 type=Level irqDesc=Averaged sample ready
    ADC24_DONE1_IRQ cpuLine=IRQRTR_SII_100,M55HE_IRQS_164,M55HP_IRQS_164 cpuLineNum=100,164,164 type=Level irqDesc=All samples taken
  CMP0
    CMP0_IRQ cpuLine=IRQRTR_SII_103,M55HE_IRQS_167,M55HP_IRQS_167 cpuLineNum=103,167,167 type=Level irqDesc=Comparator result changed
  CMP1
    CMP1_IRQ cpuLine=IRQRTR_SII_104,M55HE_IRQS_168,M55HP_IRQS_168 cpuLineNum=104,168,168 type=Level irqDesc=Comparator result changed
  CMP2
    CMP2_IRQ cpuLine=IRQRTR_SII_105,M55HE_IRQS_169,M55HP_IRQS_169 cpuLineNum=105,169,169 type=Level irqDesc=Comparator result changed
  CMP3
    CMP3_IRQ cpuLine=IRQRTR_SII_106,M55HE_IRQS_170,M55HP_IRQS_170 cpuLineNum=106,170,170 type=Level irqDesc=Comparator result changed
  CANFD0
    CANFD0_IRQ cpuLine=M55HE_IRQS_104,M55HP_IRQS_104,IRQRTR_SII_40 cpuLineNum=104,104,40 type=Level irqDesc=CANFD0 Interrupt request
  ETH
    ETH_PMT_IRQ cpuLine=M55HE_IRQS_149,M55HP_IRQS_149,IRQRTR_SII_85 cpuLineNum=149,149,85 type=Level irqDesc=Non-maskable interrupt generated when the MAC receives remote wake-up frame or magic packet
    ETH_SBD_IRQ cpuLine=M55HE_IRQS_148,M55HP_IRQS_148,IRQRTR_SII_84 cpuLineNum=148,148,84 type=Level irqDesc=ETH main interrupt asserted by many events. Its value can also be read via the ETH_STAT0[SBD_INTR_O] bit.
  I2C0
    I2C0_IRQ cpuLine=M55HE_IRQS_132,M55HP_IRQS_132,IRQRTR_SII_68 cpuLineNum=132,132,68 type=Level irqDesc=I2C0 interrupt request
  I2C1
    I2C1_IRQ cpuLine=M55HE_IRQS_133,M55HP_IRQS_133,IRQRTR_SII_69 cpuLineNum=133,133,69 type=Level irqDesc=I2C1 interrupt request
  I2C2
    I2C2_IRQ cpuLine=M55HE_IRQS_134,M55HP_IRQS_134,IRQRTR_SII_70 cpuLineNum=134,134,70 type=Level irqDesc=I2C2 interrupt request
  I2C3
    I2C3_IRQ cpuLine=M55HE_IRQS_135,M55HP_IRQS_135,IRQRTR_SII_71 cpuLineNum=135,135,71 type=Level irqDesc=I2C3 interrupt request
  I2S0
    I2S0_IRQ cpuLine=M55HE_IRQS_141,M55HP_IRQS_141,IRQRTR_SII_77 cpuLineNum=141,141,77 type=Level irqDesc=I2S0 interrupt request
  I2S1
    I2S1_IRQ cpuLine=M55HE_IRQS_142,M55HP_IRQS_142,IRQRTR_SII_78 cpuLineNum=142,142,78 type=Level irqDesc=I2S1 interrupt request
  I2S2
    I2S2_IRQ cpuLine=M55HE_IRQS_143,M55HP_IRQS_143,IRQRTR_SII_79 cpuLineNum=143,143,79 type=Level irqDesc=I2S2 interrupt request
  I2S3
    I2S3_IRQ cpuLine=M55HE_IRQS_144,M55HP_IRQS_144,IRQRTR_SII_80 cpuLineNum=144,144,80 type=Level irqDesc=I2S3 interrupt request
  I3C
    I3C_IRQ cpuLine=M55HE_IRQS_136,M55HP_IRQS_136,IRQRTR_SII_72 cpuLineNum=136,136,72 type=Level irqDesc=I3C interrupt request
  PDM
    PDM_AUDIO_DET_IRQ cpuLine=M55HE_IRQS_147,M55HP_IRQS_147,IRQRTR_SII_83 cpuLineNum=147,147,83 type=Edge irqDesc=PDM Audio peak detection interrupt request
    PDM_ERROR_IRQ cpuLine=M55HE_IRQS_146,M55HP_IRQS_146,IRQRTR_SII_82 cpuLineNum=146,146,82 type=Edge irqDesc=PDM Error interrupt request
    PDM_WARN_IRQ cpuLine=M55HE_IRQS_145,M55HP_IRQS_145,IRQRTR_SII_81 cpuLineNum=145,145,81 type=Level irqDesc=PDM Warning interrupt request
  SPI0
    SPI0_IRQ cpuLine=M55HE_IRQS_137,M55HP_IRQS_137,IRQRTR_SII_73 cpuLineNum=137,137,73 type=Level irqDesc=SPI0 interrupt request
  SPI1
    SPI1_IRQ cpuLine=M55HE_IRQS_138,M55HP_IRQS_138,IRQRTR_SII_74 cpuLineNum=138,138,74 type=Level irqDesc=SPI1 interrupt request
  SPI2
    SPI2_IRQ cpuLine=M55HE_IRQS_139,M55HP_IRQS_139,IRQRTR_SII_75 cpuLineNum=139,139,75 type=Level irqDesc=SPI2 interrupt request
  SPI3
    SPI3_IRQ cpuLine=M55HE_IRQS_140,M55HP_IRQS_140,IRQRTR_SII_76 cpuLineNum=140,140,76 type=Level irqDesc=SPI3 interrupt request
  UART{n} (n=0..7)
    UART{n}_IRQ cpuLine=M55HE_IRQS_{n+124},M55HP_IRQS_{n+124},IRQRTR_SII_{n+60} cpuLineNum={n+124},{n+124},{n+60} type=Level irqDesc=UART{n} interrupt request
  USB
    USB_IRQ cpuLine=M55HE_IRQS_101,M55HP_IRQS_101,IRQRTR_SII_37 cpuLineNum=101,101,37 type=Level irqDesc=USB interrupt
  UTIMER0
    UTIMER_IRQ{n} cpuLine=IRQRTR_SII_{n+313},M55HE_IRQS_{n+377},M55HP_IRQS_{n+377} cpuLineNum={n+313},{n+377},{n+377} type=Level irqDesc=Channel 0, interrupt request {n} (n=0..7)
  UTIMER1
    UTIMER_IRQ{n} cpuLine=IRQRTR_SII_{n+313},M55HE_IRQS_{n+377},M55HP_IRQS_{n+377} cpuLineNum={n+313},{n+377},{n+377} type=Level irqDesc=Channel 1, interrupt request {n} (n=8..15)
  UTIMER2
    UTIMER_IRQ{n} cpuLine=IRQRTR_SII_{n+313},M55HE_IRQS_{n+377},M55HP_IRQS_{n+377} cpuLineNum={n+313},{n+377},{n+377} type=Level irqDesc=Channel 2, interrupt request {n} (n=16..23)
  UTIMER3
    UTIMER_IRQ{n} cpuLine=IRQRTR_SII_{n+313},M55HE_IRQS_{n+377},M55HP_IRQS_{n+377} cpuLineNum={n+313},{n+377},{n+377} type=Level irqDesc=Channel 3, interrupt request {n} (n=24..31)
  UTIMER4
    UTIMER_IRQ{n} cpuLine=IRQRTR_SII_{n+313},M55HE_IRQS_{n+377},M55HP_IRQS_{n+377} cpuLineNum={n+313},{n+377},{n+377} type=Level irqDesc=Channel 4, interrupt request {n} (n=32..39)
  UTIMER5
    UTIMER_IRQ{n} cpuLine=IRQRTR_SII_{n+313},M55HE_IRQS_{n+377},M55HP_IRQS_{n+377} cpuLineNum={n+313},{n+377},{n+377} type=Level irqDesc=Channel 5, interrupt request {n} (n=40..47)
  UTIMER6
    UTIMER_IRQ{n} cpuLine=IRQRTR_SII_{n+313},M55HE_IRQS_{n+377},M55HP_IRQS_{n+377} cpuLineNum={n+313},{n+377},{n+377} type=Level irqDesc=Channel 6, interrupt request {n} (n=48..55)
  UTIMER7
    UTIMER_IRQ{n} cpuLine=IRQRTR_SII_{n+313},M55HE_IRQS_{n+377},M55HP_IRQS_{n+377} cpuLineNum={n+313},{n+377},{n+377} type=Level irqDesc=Channel 7, interrupt request {n} (n=56..63)
  UTIMER8
    UTIMER_IRQ{n} cpuLine=IRQRTR_SII_{n+313},M55HE_IRQS_{n+377},M55HP_IRQS_{n+377} cpuLineNum={n+313},{n+377},{n+377} type=Level irqDesc=Channel 8, interrupt request {n} (n=64..71)
  UTIMER9
    UTIMER_IRQ{n} cpuLine=IRQRTR_SII_{n+313},M55HE_IRQS_{n+377},M55HP_IRQS_{n+377} cpuLineNum={n+313},{n+377},{n+377} type=Level irqDesc=Channel 9, interrupt request {n} (n=72..79)
  UTIMER10
    UTIMER_IRQ{n} cpuLine=IRQRTR_SII_{n+313},M55HE_IRQS_{n+377},M55HP_IRQS_{n+377} cpuLineNum={n+313},{n+377},{n+377} type=Level irqDesc=Channel 10, interrupt request {n} (n=80..87)
  UTIMER11
    UTIMER_IRQ{n} cpuLine=IRQRTR_SII_{n+313},M55HE_IRQS_{n+377},M55HP_IRQS_{n+377} cpuLineNum={n+313},{n+377},{n+377} type=Level irqDesc=Channel 11, interrupt request {n} (n=88..95)
  QEC0
    QEC0_CMPA_IRQ cpuLine=IRQRTR_SII_305,M55HE_IRQS_369,M55HP_IRQS_369 cpuLineNum=305,369,369 type=Level irqDesc=Channel 12 interrupt request at driver A
    QEC0_CMPB_IRQ cpuLine=IRQRTR_SII_309,M55HE_IRQS_373,M55HP_IRQS_373 cpuLineNum=309,373,373 type=Level irqDesc=Channel 12 interrupt request at driver B
  QEC1
    QEC1_CMPA_IRQ cpuLine=IRQRTR_SII_306,M55HE_IRQS_370,M55HP_IRQS_370 cpuLineNum=306,370,370 type=Level irqDesc=Channel 13 interrupt request at driver A
    QEC1_CMPB_IRQ cpuLine=IRQRTR_SII_310,M55HE_IRQS_374,M55HP_IRQS_374 cpuLineNum=310,374,374 type=Level irqDesc=Channel 13 interrupt request at driver B
  QEC2
    QEC2_CMPA_IRQ cpuLine=IRQRTR_SII_307,M55HE_IRQS_371,M55HP_IRQS_371 cpuLineNum=307,371,371 type=Level irqDesc=Channel 14 interrupt request at driver A
    QEC2_CMPB_IRQ cpuLine=IRQRTR_SII_311,M55HE_IRQS_375,M55HP_IRQS_375 cpuLineNum=311,375,375 type=Level irqDesc=Channel 14 interrupt request at driver B
  QEC3
    QEC3_CMPA_IRQ cpuLine=IRQRTR_SII_308,M55HE_IRQS_372,M55HP_IRQS_372 cpuLineNum=308,372,372 type=Level irqDesc=Channel 15 interrupt request at driver A
    QEC3_CMPB_IRQ cpuLine=IRQRTR_SII_312,M55HE_IRQS_376,M55HP_IRQS_376 cpuLineNum=312,376,376 type=Level irqDesc=Channel 15 interrupt request at driver B
  SDMMC
    SDMMC_IRQ cpuLine=M55HE_IRQS_102,M55HP_IRQS_102,IRQRTR_SII_38 cpuLineNum=102,102,38 type=Level irqDesc=SDMMC Interrupt request
    SDMMC_WAKEUP_IRQ cpuLine=M55HE_IRQS_103,M55HP_IRQS_103,IRQRTR_SII_39 cpuLineNum=103,103,39 type=Level irqDesc=SDMMC Wakeup event interrupt request
  OSPI0
    OSPI0_IRQ cpuLine=IRQRTR_SII_32,M55HE_IRQS_96,M55HP_IRQS_96 cpuLineNum=32,96,96 type=Level
  OSPI1
    OSPI1_IRQ cpuLine=IRQRTR_SII_33,M55HE_IRQS_97,M55HP_IRQS_97 cpuLineNum=33,97,97 type=Level
  AES0
    AES0_IRQ cpuLine=IRQRTR_SII_34,M55HE_IRQS_98,M55HP_IRQS_98 cpuLineNum=34,98,98 type=Level
  AES1
    AES1_IRQ cpuLine=IRQRTR_SII_35,M55HE_IRQS_99,M55HP_IRQS_99 cpuLineNum=35,99,99 type=Level
  DMA1_SEC
    DMA1_IRQ{n} cpuLine=M55HP_IRQS_{n} cpuLineNum={n} type=Level irqDesc=Interrupt request {n}. One per DMA request interface (32 in total). (n=0..31)
    DMA1_IRQ_ABORT cpuLine=M55HP_IRQS_32 cpuLineNum=32 type=Level irqDesc=DMAC aborted execution of a program thread.
  DMA1_NS
    DMA1_IRQ{n} cpuLine=M55HP_IRQS_{n} cpuLineNum={n} type=Level irqDesc=Interrupt request {n}. One per DMA request interface (32 in total). (n=0..31)
    DMA1_IRQ_ABORT cpuLine=M55HP_IRQS_32 cpuLineNum=32 type=Level irqDesc=DMAC aborted execution of a program thread.
  DMA2_SEC
    DMA2_IRQ{n} cpuLine=M55HE_IRQS_{n} cpuLineNum={n} type=Level irqDesc=Interrupt request {n}. One per DMA request interface (32 in total). (n=0..31)
    DMA2_IRQ_ABORT cpuLine=M55HE_IRQS_32 cpuLineNum=32 type=Level irqDesc=DMAC aborted execution of a program thread.
  DMA2_NS
    DMA2_IRQ{n} cpuLine=M55HE_IRQS_{n} cpuLineNum={n} type=Level irqDesc=Interrupt request {n}. One per DMA request interface (32 in total). (n=0..31)
    DMA2_IRQ_ABORT cpuLine=M55HE_IRQS_32 cpuLineNum=32 type=Level irqDesc=DMAC aborted execution of a program thread.
  REFCLK_CNTBase0
    REFCLK_CNTBASE0_IRQ cpuLine=IRQRTR_SII_3,M55HP_IRQS_67,M55HE_IRQS_67 cpuLineNum=3,67,67 type=Level irqDesc=Interrupt generated when the timer condition is met. See registers CNTP_TVAL and CNTP_CTL for the timer condition definition.
  REFCLK_CNTBase1
    REFCLK_CNTBASE1_IRQ cpuLine=IRQRTR_SII_4,M55HP_IRQS_68,M55HE_IRQS_68 cpuLineNum=4,68,68 type=Level irqDesc=Interrupt generated when the timer condition is met. See registers CNTP_TVAL and CNTP_CTL for the timer condition definition.
  REFCLK_CNTBase2
    REFCLK_CNTBASE2_IRQ cpuLine=IRQRTR_SII_5,M55HP_IRQS_69,M55HE_IRQS_69 cpuLineNum=5,69,69 type=Level irqDesc=Interrupt generated when the timer condition is met. See registers CNTP_TVAL and CNTP_CTL for the timer condition definition.
  REFCLK_CNTBase3
    REFCLK_CNTBASE3_IRQ cpuLine=IRQRTR_SII_6,M55HP_IRQS_70,M55HE_IRQS_70 cpuLineNum=6,70,70 type=Level irqDesc=Interrupt generated when the timer condition is met. See registers CNTP_TVAL and CNTP_CTL for the timer condition definition.
  S32K_CNTBase0
    S32K_CNTBASE0_IRQ cpuLine=IRQRTR_SII_7,M55HP_IRQS_71,M55HE_IRQS_71 cpuLineNum=7,71,71 type=Level irqDesc=Interrupt generated when the timer condition is met. See registers CNTP_TVAL and CNTP_CTL for the timer condition definition.
  S32K_CNTBase1
    S32K_CNTBASE1_IRQ cpuLine=IRQRTR_SII_8,M55HP_IRQS_72,M55HE_IRQS_72 cpuLineNum=8,72,72 type=Level irqDesc=Interrupt generated when the timer condition is met. See registers CNTP_TVAL and CNTP_CTL for the timer condition definition.
  BOD
    BOD_IRQ cpuLine=IRQRTR_SII_36,M55HP_IRQS_100,M55HE_IRQS_100 cpuLineNum=36,100,100 type=Level irqDesc=Voltage below threshold
  MHU_SECPU_M55HE_0_RX
    MHU_SECPU_M55HE_0_RX_IRQ cpuLine=M55HE_IRQS_37 cpuLineNum=37 type=Level irqDesc=Interrupt
  MHU_M55HE_SECPU_0_TX
    MHU_M55HE_SECPU_0_TX_IRQ cpuLine=M55HE_IRQS_38 cpuLineNum=38 type=Level irqDesc=Interrupt
  MHU_SECPU_M55HE_1_RX
    MHU_SECPU_M55HE_1_RX_IRQ cpuLine=M55HE_IRQS_39 cpuLineNum=39 type=Level irqDesc=Interrupt
  MHU_M55HE_SECPU_1_TX
    MHU_M55HE_SECPU_1_TX_IRQ cpuLine=M55HE_IRQS_40 cpuLineNum=40 type=Level irqDesc=Interrupt
  MHU_M55HP_M55HE_0_RX
    MHU_M55HP_M55HE_0_RX_IRQ cpuLine=M55HE_IRQS_41 cpuLineNum=41 type=Level irqDesc=Interrupt
  MHU_M55HE_M55HP_0_TX
    MHU_M55HE_M55HP_0_TX_IRQ cpuLine=M55HE_IRQS_42 cpuLineNum=42 type=Level irqDesc=Interrupt
  MHU_M55HP_M55HE_1_RX
    MHU_M55HP_M55HE_1_RX_IRQ cpuLine=M55HE_IRQS_43 cpuLineNum=43 type=Level irqDesc=Interrupt
  MHU_M55HE_M55HP_1_TX
    MHU_M55HE_M55HP_1_TX_IRQ cpuLine=M55HE_IRQS_44 cpuLineNum=44 type=Level irqDesc=Interrupt
  MHU_SECPU_M55HP_0_RX
    MHU_SECPU_M55HP_0_RX_IRQ cpuLine=M55HP_IRQS_37 cpuLineNum=37 type=Level irqDesc=Interrupt
  MHU_M55HP_SECPU_0_TX
    MHU_M55HP_SECPU_0_TX_IRQ cpuLine=M55HP_IRQS_38 cpuLineNum=38 type=Level irqDesc=Interrupt
  MHU_SECPU_M55HP_1_RX
    MHU_SECPU_M55HP_1_RX_IRQ cpuLine=M55HP_IRQS_39 cpuLineNum=39 type=Level irqDesc=Interrupt
  MHU_M55HP_SECPU_1_TX
    MHU_M55HP_SECPU_1_TX_IRQ cpuLine=M55HP_IRQS_40 cpuLineNum=40 type=Level irqDesc=Interrupt
  MHU_M55HE_M55HP_0_RX
    MHU_M55HE_M55HP_0_RX_IRQ cpuLine=M55HP_IRQS_41 cpuLineNum=41 type=Level irqDesc=Interrupt
  MHU_M55HP_M55HE_0_TX
    MHU_M55HP_M55HE_0_TX_IRQ cpuLine=M55HP_IRQS_42 cpuLineNum=42 type=Level irqDesc=Interrupt
  MHU_M55HE_M55HP_1_RX
    MHU_M55HE_M55HP_1_RX_IRQ cpuLine=M55HP_IRQS_43 cpuLineNum=43 type=Level irqDesc=Interrupt
  MHU_M55HP_M55HE_1_TX
    MHU_M55HP_M55HE_1_TX_IRQ cpuLine=M55HP_IRQS_44 cpuLineNum=44 type=Level irqDesc=Interrupt
dreqs:
  LPTIMER0
    LPTIMER0_DMA_REQ dmaLine=DMA0_REQ_0,DMA2_REQ_0 dreqDesc=Request to DMA0 controller
  LPTIMER1
    LPTIMER1_DMA_REQ dmaLine=DMA0_REQ_1,DMA2_REQ_1 dreqDesc=Request to DMA0 controller
  LPTIMER2
    LPTIMER2_DMA_REQ dmaLine=DMA0_REQ_2,DMA2_REQ_2 dreqDesc=Request to DMA0 controller
  LPTIMER3
    LPTIMER3_DMA_REQ dmaLine=DMA0_REQ_3,DMA2_REQ_3 dreqDesc=Request to DMA0 controller
  UTIMER0
    UT0_T0_DMA_REQ dmaLine=DMA0_REQ_0,DMA1_REQ_8 dreqDesc=UT0_T0 DMA request
    UT0_T1_DMA_REQ dmaLine=DMA0_REQ_1,DMA1_REQ_9 dreqDesc=UT0_T1 DMA request
  UTIMER1
    UT1_T0_DMA_REQ dmaLine=DMA0_REQ_2,DMA1_REQ_10 dreqDesc=UT1_T0 DMA request
    UT1_T1_DMA_REQ dmaLine=DMA0_REQ_3,DMA1_REQ_11 dreqDesc=UT1_T1 DMA request
  UTIMER2
    UT2_T0_DMA_REQ dmaLine=DMA0_REQ_4,DMA1_REQ_12 dreqDesc=UT2_T0 DMA request
    UT2_T1_DMA_REQ dmaLine=DMA0_REQ_5,DMA1_REQ_13 dreqDesc=UT2_T1 DMA request
  UTIMER3
    UT3_T0_DMA_REQ dmaLine=DMA0_REQ_6,DMA1_REQ_14 dreqDesc=UT3_T0 DMA request
    UT3_T1_DMA_REQ dmaLine=DMA0_REQ_7,DMA1_REQ_15 dreqDesc=UT3_T1 DMA request
  UTIMER4
    UT4_T0_DMA_REQ dmaLine=DMA0_REQ_8 dreqDesc=UT4_T0 DMA request
    UT4_T1_DMA_REQ dmaLine=DMA0_REQ_9 dreqDesc=UT4_T1 DMA request
  UTIMER5
    UT5_T0_DMA_REQ dmaLine=DMA0_REQ_10 dreqDesc=UT5_T0 DMA request
    UT5_T1_DMA_REQ dmaLine=DMA0_REQ_11 dreqDesc=UT5_T1 DMA request
  UTIMER6
    UT6_T0_DMA_REQ dmaLine=DMA0_REQ_12 dreqDesc=UT6_T0 DMA request
    UT6_T1_DMA_REQ dmaLine=DMA0_REQ_13 dreqDesc=UT6_T1 DMA request
  UTIMER7
    UT7_T0_DMA_REQ dmaLine=DMA0_REQ_14 dreqDesc=UT7_T0 DMA request
    UT7_T1_DMA_REQ dmaLine=DMA0_REQ_15 dreqDesc=UT7_T1 DMA request
  QEC0
    QEC0_DMA_REQ dmaLine=DMA0_REQ_4 dreqDesc=QEC0 DMA request
  QEC1
    QEC1_DMA_REQ dmaLine=DMA0_REQ_5 dreqDesc=QEC1 DMA request
  QEC2
    QEC2_DMA_REQ dmaLine=DMA0_REQ_6 dreqDesc=QEC2 DMA request
  QEC3
    QEC3_DMA_REQ dmaLine=DMA0_REQ_7 dreqDesc=QEC3 DMA request
  GPIO3
    GPIO3_{n}_DMA_REQ dmaLine=DMA0_REQ_{n} dreqDesc=GPIO3 pin {n} request (n=0..7)
  GPIO4
    GPIO4_{n}_DMA_REQ dmaLine=DMA0_REQ_{n+8} dreqDesc=GPIO4 pin {n} request (n=0..7)
  GPIO7
    GPIO7_{n}_DMA_REQ dmaLine=DMA0_REQ_{n+16} dreqDesc=GPIO7 pin {n} request (n=0..7)
  GPIO8
    GPIO8_{n}_DMA_REQ dmaLine=DMA0_REQ_{n+24} dreqDesc=GPIO8 pin {n} request (n=0..7)
  GPIO9
    GPIO9_{n}_DMA_REQ dmaLine=DMA1_REQ_{n+24} dreqDesc=GPIO9 pin {n} request (n=0..7)
  GPIO16
    GPIO16_{n}_DMA_REQ dmaLine=DMA2_REQ_{n+24} dreqDesc=GPIO16 pin {n} request (n=0..7)
  CANFD0
    CANFD0_DMA_RX_REQ dmaLine=DMA0_REQ_22,DMA2_REQ_22 dreqDesc=CANFD0 Receive DMA request
    CANFD0_DMA_TX_REQ dmaLine=DMA0_REQ_23,DMA2_REQ_23 dreqDesc=CANFD0 Transmit DMA request
  I2C0
    I2C0_DMA_RX_REQ dmaLine=DMA0_REQ_24 dreqDesc=I2C0 receive request
    I2C0_DMA_TX_REQ dmaLine=DMA0_REQ_28 dreqDesc=I2C0 transmit request
  I2C1
    I2C1_DMA_RX_REQ dmaLine=DMA0_REQ_25 dreqDesc=I2C1 receive request
    I2C1_DMA_TX_REQ dmaLine=DMA0_REQ_29 dreqDesc=I2C1 transmit request
  I2C2
    I2C2_DMA_RX_REQ dmaLine=DMA0_REQ_26 dreqDesc=I2C2 receive request
    I2C2_DMA_TX_REQ dmaLine=DMA0_REQ_30 dreqDesc=I2C2 transmit request
  I2C3
    I2C3_DMA_RX_REQ dmaLine=DMA0_REQ_27 dreqDesc=I2C3 receive request
    I2C3_DMA_TX_REQ dmaLine=DMA0_REQ_31 dreqDesc=I2C3 transmit request
  LPI2C0
    LPI2C0_DMA_RX_REQ dmaLine=DMA0_REQ_10 dreqDesc=LPI2C0 receive request
    LPI2C0_DMA_TX_REQ dmaLine=DMA0_REQ_11 dreqDesc=LPI2C0 transmit request
  LPI2C1
    LPI2C1_DMA_RX_REQ dmaLine=DMA2_REQ_10 dreqDesc=LPI2C1 receive request
    LPI2C1_DMA_TX_REQ dmaLine=DMA2_REQ_11 dreqDesc=LPI2C1 transmit request
  I2S0
    I2S_0_DMA_RX_REQ dmaLine=DMA0_REQ_24 dreqDesc=I2S0 Receive DMA request
    I2S_0_DMA_TX_REQ dmaLine=DMA0_REQ_28 dreqDesc=I2S0 Transmit DMA request
  I2S1
    I2S_1_DMA_RX_REQ dmaLine=DMA0_REQ_25 dreqDesc=I2S1 Receive DMA request
    I2S_1_DMA_TX_REQ dmaLine=DMA0_REQ_29 dreqDesc=I2S1 Transmit DMA request
  I2S2
    I2S_2_DMA_RX_REQ dmaLine=DMA0_REQ_26 dreqDesc=I2S2 Receive DMA request
    I2S_2_DMA_TX_REQ dmaLine=DMA0_REQ_30 dreqDesc=I2S2 Transmit DMA request
  I2S3
    I2S_3_DMA_RX_REQ dmaLine=DMA0_REQ_27 dreqDesc=I2S3 Receive DMA request
    I2S_3_DMA_TX_REQ dmaLine=DMA0_REQ_31 dreqDesc=I2S3 Transmit DMA request
  LPI2S
    LPI2S_DMA_RX_REQ dmaLine=DMA0_REQ_14,DMA2_REQ_14 dreqDesc=LPI2S Receive DMA request
    LPI2S_DMA_TX_REQ dmaLine=DMA0_REQ_15,DMA2_REQ_15 dreqDesc=LPI2S Transmit DMA request
  I3C
    I3C_DMA_RX_REQ dmaLine=DMA0_REQ_20,DMA2_REQ_20 dreqDesc=I3C receive request
    I3C_DMA_TX_REQ dmaLine=DMA0_REQ_21,DMA2_REQ_21 dreqDesc=I3C transmit request
  LPI3C
    LPI3C_DMA_RX_REQ dmaLine=DMA0_REQ_20,DMA2_REQ_20 dreqDesc=LPI3C receive request
    LPI3C_DMA_TX_REQ dmaLine=DMA0_REQ_21,DMA2_REQ_21 dreqDesc=LPI3C transmit request
  PDM
    PDM_DMA_REQ dmaLine=DMA0_REQ_31 dreqDesc=PDM DMA request
  LPPDM
    LPPDM_DMA_REQ dmaLine=DMA0_REQ_30,DMA2_REQ_19 dreqDesc=LPPDM DMA request
  SPI0
    SPI0_DMA_RX_REQ dmaLine=DMA0_REQ_16 dreqDesc=SPI0 receive DMA request
    SPI0_DMA_TX_REQ dmaLine=DMA0_REQ_20 dreqDesc=SPI0 transmit DMA request
  SPI1
    SPI1_DMA_RX_REQ dmaLine=DMA0_REQ_17 dreqDesc=SPI1 receive DMA request
    SPI1_DMA_TX_REQ dmaLine=DMA0_REQ_21 dreqDesc=SPI1 transmit DMA request
  SPI2
    SPI2_DMA_RX_REQ dmaLine=DMA0_REQ_18 dreqDesc=SPI2 receive DMA request
    SPI2_DMA_TX_REQ dmaLine=DMA0_REQ_22 dreqDesc=SPI2 transmit DMA request
  SPI3
    SPI3_DMA_RX_REQ dmaLine=DMA0_REQ_19 dreqDesc=SPI3 receive DMA request
    SPI3_DMA_TX_REQ dmaLine=DMA0_REQ_23 dreqDesc=SPI3 transmit DMA request
  LPSPI0
    LPSPI0_DMA_RX_REQ dmaLine=DMA0_REQ_12,DMA0_REQ_24,DMA2_REQ_12 dreqDesc=LPSPI0 receive DMA request
    LPSPI0_DMA_TX_REQ dmaLine=DMA0_REQ_13,DMA0_REQ_25,DMA2_REQ_13 dreqDesc=LPSPI0 transmit DMA request
  UART0
    UART0_DMA_RX_REQ dmaLine=DMA0_REQ_8 dreqDesc=UART0 receive request
    UART0_DMA_TX_REQ dmaLine=DMA0_REQ_16 dreqDesc=UART0 transmit request
  UART1
    UART1_DMA_RX_REQ dmaLine=DMA0_REQ_9 dreqDesc=UART1 receive request
    UART1_DMA_TX_REQ dmaLine=DMA0_REQ_17 dreqDesc=UART1 transmit request
  UART2
    UART2_DMA_RX_REQ dmaLine=DMA0_REQ_10 dreqDesc=UART2 receive request
    UART2_DMA_TX_REQ dmaLine=DMA0_REQ_18 dreqDesc=UART2 transmit request
  UART3
    UART3_DMA_RX_REQ dmaLine=DMA0_REQ_11 dreqDesc=UART3 receive request
    UART3_DMA_TX_REQ dmaLine=DMA0_REQ_19 dreqDesc=UART3 transmit request
  UART4
    UART4_DMA_RX_REQ dmaLine=DMA0_REQ_12,DMA1_REQ_16 dreqDesc=UART4 receive request
    UART4_DMA_TX_REQ dmaLine=DMA0_REQ_20,DMA1_REQ_20 dreqDesc=UART4 transmit request
  UART5
    UART5_DMA_RX_REQ dmaLine=DMA0_REQ_13,DMA1_REQ_17 dreqDesc=UART5 receive request
    UART5_DMA_TX_REQ dmaLine=DMA0_REQ_21,DMA1_REQ_21 dreqDesc=UART5 transmit request
  UART6
    UART6_DMA_RX_REQ dmaLine=DMA0_REQ_14,DMA1_REQ_18 dreqDesc=UART6 receive request
    UART6_DMA_TX_REQ dmaLine=DMA0_REQ_22,DMA1_REQ_22 dreqDesc=UART6 transmit request
  UART7
    UART7_DMA_RX_REQ dmaLine=DMA0_REQ_15,DMA1_REQ_19 dreqDesc=UART7 receive request
    UART7_DMA_TX_REQ dmaLine=DMA0_REQ_23,DMA1_REQ_23 dreqDesc=UART7 transmit request
  LPUART
    LPUART_DMA_RX_REQ dmaLine=DMA0_REQ_8,DMA2_REQ_8 dreqDesc=LPUART receive request
    LPUART_DMA_TX_REQ dmaLine=DMA0_REQ_9,DMA2_REQ_9 dreqDesc=LPUART transmit request
  CPI
    CAM_VSYNC_DMA_REQ dmaLine=DMA0_REQ_26 dreqDesc=CPI VSYNC DMA request
    CAM_HSYNC_DMA_REQ dmaLine=DMA0_REQ_27 dreqDesc=CPI HSYNC DMA request
  LPCPI
    LPCAM_VSYNC_DMA_REQ dmaLine=DMA2_REQ_16 dreqDesc=LPCPI VSYNC DMA request
    LPCAM_HSYNC_DMA_REQ dmaLine=DMA2_REQ_17 dreqDesc=LPCPI HSYNC DMA request
  CDC
    CDC_VSYNC_DMA_REQ dmaLine=DMA0_REQ_28 dreqDesc=CDC VSYNC DMA request
    CDC_HSYNC_DMA_REQ dmaLine=DMA0_REQ_29 dreqDesc=CDC HSYNC DMA request
  ADC120
    ADC120_DONE0_DMA_REQ dmaLine=DMA0_REQ_4,UT_EVENT_4,DMA2_REQ_4 dreqDesc=Averaged sample ready
  ADC121
    ADC121_DONE0_DMA_REQ dmaLine=DMA0_REQ_5,UT_EVENT_5,DMA2_REQ_5 dreqDesc=Averaged sample ready
  ADC122
    ADC122_DONE0_DMA_REQ dmaLine=DMA0_REQ_6,UT_EVENT_6,DMA2_REQ_6 dreqDesc=Averaged sample ready
  ADC24
    ADC24_DONE0_DMA_REQ dmaLine=DMA0_REQ_10,UT_EVENT_10,DMA2_REQ_10 dreqDesc=Averaged sample ready
    ADC24_DONE1_DMA_REQ dmaLine=DMA0_REQ_11,UT_EVENT_11,DMA2_REQ_11 dreqDesc=All samples taken
  CMP0
    CMP0_DMA_REQ dmaLine=DMA0_REQ_0,UT_EVENT_0,DMA1_REQ_0 dreqDesc=Comparator result changed
  CMP1
    CMP1_DMA_REQ dmaLine=DMA0_REQ_1,UT_EVENT_1,DMA1_REQ_1 dreqDesc=Comparator result changed
  CMP2
    CMP2_DMA_REQ dmaLine=DMA0_REQ_2,UT_EVENT_2,DMA1_REQ_2 dreqDesc=Comparator result changed
  CMP3
    CMP3_DMA_REQ dmaLine=DMA0_REQ_3,UT_EVENT_3,DMA1_REQ_3 dreqDesc=Comparator result changed
  LPCMP
    LPCMP_DMA_REQ dmaLine=DMA2_REQ_18 dreqDesc=Comparator output changed
  BOD
    BOD_DMA_REQ dmaLine=DMA0_REQ_7,UT_EVENT_7,DMA2_REQ_7 dreqDesc=Voltage below threshold

## Licence text in the file
THIS SOFTWARE IS PROVIDED "AS IS". NO WARRANTIES, WHETHER EXPRESS, IMPLIED. OR STATUTORY, INCLUDING, BUT NOT LIMITED TO, IMPLIED WARRANTIES OF. MERCHANTABILITY AND FITNESS FOR A PARTICULAR PURPOSE APPLY TO THIS SOFTWARE. ALIF SHALL NOT, IN ANY CIRCUMSTANCES, BE LIABLE FOR SPECIAL, INCIDENTAL, OR. CONSEQUENTIAL DAMAGES, FOR ANY REASON WHATSOEVER.
