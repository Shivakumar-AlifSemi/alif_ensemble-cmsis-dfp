# AE402FA0E5597BE0_CM55_HE_View register map
Vendor: Alif Semiconductor; Series: E4; File version: 1.0
The families of fusion processors and microcontrollers (MCUs) from Alif Semiconductor create a scalable and compatible continuum of highly integrated embedded processor devices for use in low-end to high-end intelligent IoT end-point applications. Architected for power efficiency and long battery life, these devices deliver high computation and ML/AI capability, multi-layered security, computer vision, and highly interactive human-machine interface.
CPU: CM55 r1p0, selectable endian, MPU, FPU, double-precision FPU, DSP, VTOR, 8 interrupt priority bits, 1 SAU regions
Registers are 32-bit, read-write, reset 0x0 unless marked. A register's access mark holds for its fields unless they carry their own. Offsets are from the block's base; lines under a group give offsets from that group; [hi:lo] are bit positions; {n}, {i} and the like mark numbered series; 'fields as' and 'values as' point back to an identical list; <NAME> marks a mode.

## Memory map
0x1A010000 CLKCTL_SYS blocks up to offset 0x828
0x1A200000 REFCLK_CNTControl size 0x10
0x1A210000 REFCLK_CNTRead size 0x8
0x1A220000 REFCLK_CNTCtl size 0xA0
0x1A230000 REFCLK_CNTBase0 size 0x40
0x1A240000 REFCLK_CNTBase1 size 0x40
0x1A250000 REFCLK_CNTBase2 size 0x40
0x1A260000 REFCLK_CNTBase3 size 0x40
0x1A400000 S32K_CNTControl size 0x10
0x1A410000 S32K_CNTRead size 0x8
0x1A420000 S32K_CNTCtl size 0xA0
0x1A430000 S32K_CNTBase0 size 0x40
0x1A440000 S32K_CNTBase1 size 0x40
0x1A500000 IRQRTR size 0xFB4
0x1A602000 CGU size 0x2C
0x1A603000 PINMUX size 0x240
0x1A604000 AON size 0x48
0x1A609000 VBAT size 0x14
0x1A60A000 ANA size 0x44
0x1A60F000 STOP_MODE size 0x4
0x40040000 MHU_SECPU_M55HE_0_RX size 0x1000
0x40050000 MHU_M55HE_SECPU_0_TX size 0x1000
0x40060000 MHU_SECPU_M55HE_1_RX size 0x1000
0x40070000 MHU_M55HE_SECPU_1_TX size 0x1000
0x40080000 MHU_M55HP_M55HE_0_RX size 0x1000
0x40090000 MHU_M55HE_M55HP_0_TX size 0x1000
0x400A0000 MHU_M55HP_M55HE_1_RX size 0x1000
0x400B0000 MHU_M55HE_M55HP_1_TX size 0x1000
0x400C0000 DMA2_SEC size 0x1000
0x400E0000 DMA2_NS size 0x1000
0x400E1000 NPU_HE size 0x1000
0x400E2000 EVTRTR2 size 0x98
0x40100000 WDT_HE_CTRL size 0x1000
0x40101000 WDT_HE_REFRESH size 0x1000
0x42000000 LPRTC0 size 0x28
0x42001000 LPTIMER size 0xC0
0x42002000 LPGPIO size 0x110
0x42003000 LPCMP size 0x4
0x42004000 BOR_BOD size 0x4
0x42007000 LPGPIO_CTRL size 0x20
0x43000000 LPSPI0 size 0xF0
0x43001000 LPI2S size 0x264
0x43002000 LPPDM size 0x7D8
0x43003000 LPCPI size 0x54
0x43004000 LPSPI1 size 0xF0
0x43005000 LPI2C1 size 0x100
0x43006000 LPI3C size 0x284
0x43007000 M55HE_CFG size 0x28
0x43008000 LPUART size 0x100
0x43009000 LPI2C0 size 0x24
0x4300A000 GPIO16 size 0x110
0x4300B000 GPIO17 size 0x110
0x4300C000 LPUTIMER size 0x3138
0x43010000 LPGPIO_FAST size 0x110
0x48000000 UTIMER size 0x10138
0x48100000 ETH size 0x1168
0x48102000 SDMMC size 0xF70
0x48103000 SPI0 size 0xF4
0x48104000 SPI1 size 0xF4
0x48105000 SPI2 size 0xF4
0x48106000 SPI3 size 0xF4
0x48107000 CRC0 size 0x100
0x48108000 CRC1 size 0x100
0x48200000 USB size 0xCA04
{0x49000000+0x1000*n} GPIO{n} size 0x110 (n=0..14)
0x49010000 I2C0 size 0x100
0x49011000 I2C1 size 0x100
0x49012000 I2C2 size 0x100
0x49013000 I2C3 size 0x100
0x49014000 I2S0 size 0x264
0x49015000 I2S1 size 0x264
0x49016000 I2S2 size 0x264
0x49017000 I2S3 size 0x264
{0x49018000+0x1000*n} UART{n} size 0x100 (n=0..7)
0x49020000 ADC120 size 0x74
0x49021000 ADC121 size 0x74
0x49022000 ADC122 size 0x74
0x49023000 CMP0 size 0x28
0x49024000 CMP1 size 0x28
0x49025000 CMP2 size 0x28
0x49026000 CMP3 size 0x28
0x49027000 ADC24 size 0x74
0x49028000 DAC120 size 0x8
0x49029000 DAC121 size 0x8
0x4902A000 DAC6 size 0x4
0x4902B000 ADC_VREF size 0x4
0x4902D000 PDM size 0x7D8
{0x4902E000+0x10*n} HWSEM{n} size 0xC (n=0..15)
0x4902F000 CLKCTL_PER_SLV size 0xBC
0x49030000 CPI size 0x54
0x49031000 CDC size 0x254
0x49032000 DSI size 0x194
0x49033000 CSI size 0x30C
0x49034000 I3C size 0x284
0x49035000 EVTRTR0 size 0xA0
0x49036000 CANFD0 size 0xD1
0x49037000 CANFD0_CNT size 0xC
0x4903F000 CLKCTL_PER_MST size 0xB0
0x49040000 GPU2D size 0xEC
0x49042000 NPU_HG size 0x13A0
0x49044000 JPEG size 0x800
0x49046000 ISP size 0xF70
0x49080000 DMA0_SEC size 0x1000
0x490A0000 DMA0_NS size 0x1000
0x83000000 OSPI0 size 0x14C
0x83001000 AES0 size 0x7C
0x83002000 OSPI1 size 0x14C
0x83003000 AES1 size 0x7C
0xE000E100 M55HE_NVIC_S size 0x4E0
0xE002E100 M55HE_NVIC_NS size 0x4E0

## Interrupts
{n} DMA2_IRQ{n} (DMA2_SEC, DMA2_NS) (n=0..31) — Interrupt request {n}. One per DMA request interface (32 in total).
32 DMA2_IRQ_ABORT (DMA2_SEC, DMA2_NS) — DMAC aborted execution of a program thread.
37 MHU_SECPU_M55HE_0_RX_IRQ (MHU_SECPU_M55HE_0_RX) — Interrupt
38 MHU_M55HE_SECPU_0_TX_IRQ (MHU_M55HE_SECPU_0_TX) — Interrupt
39 MHU_SECPU_M55HE_1_RX_IRQ (MHU_SECPU_M55HE_1_RX) — Interrupt
40 MHU_M55HE_SECPU_1_TX_IRQ (MHU_M55HE_SECPU_1_TX) — Interrupt
41 MHU_M55HP_M55HE_0_RX_IRQ (MHU_M55HP_M55HE_0_RX) — Interrupt
42 MHU_M55HE_M55HP_0_TX_IRQ (MHU_M55HE_M55HP_0_TX) — Interrupt
43 MHU_M55HP_M55HE_1_RX_IRQ (MHU_M55HP_M55HE_1_RX) — Interrupt
44 MHU_M55HE_M55HP_1_TX_IRQ (MHU_M55HE_M55HP_1_TX) — Interrupt
45 LPUART_IRQ (LPUART) — LPUART interrupt request
46 LPSPI0_IRQ (LPSPI0) — LPSPI00/1 interrupt request
47 LPI2C0_IRQ (LPI2C0) — LPI2C0 interrupt request
48 LPI2S_IRQ (LPI2S) — LPI2S interrupt request
49 LPPDM_IRQ (LPPDM) — LPPDM combined (OR-ed) interrupt of following requests : Warning interrupt request (WARN_IRQ) Error interrupt request (ERROR_IRQ) Audio peak detection interrupt request (AUDIO_DET_IRQ) Upon interrupt assertion, the LPPDM interrupt status registers should be read to identify the source of the interrupt.
50 LPI3C_IRQ (LPI3C) — LPI3C interrupt request
51 LPI2C1_IRQ (LPI2C1) — LPI2C1 interrupt request
52 GPIO16_COMB_IRQ (GPIO16) — GPIO16 combined interrupt request
53 GPIO17_COMB_IRQ (GPIO17) — GPIO17 combined interrupt request
54 LPCAM_IRQ (LPCPI) — LPCPI interrupt
56 LPCMP_IRQ (LPCMP) — Comparator output changed
57 LPGPIO_COMB_IRQ (LPGPIO) — LPGPIO/LPGPIO_FAST combined interrupt request
58 LPRTC0_IRQ (LPRTC0) — LPRTC0 interrupt request
60 LPTIMER0_IRQ (LPTIMER) — LPTIMER0 interrupt request
61 LPTIMER1_IRQ (LPTIMER) — LPTIMER1 interrupt request
62 LPTIMER2_IRQ (LPTIMER) — LPTIMER2 interrupt request
63 LPTIMER3_IRQ (LPTIMER) — LPTIMER3 interrupt request
67 REFCLK_CNTBASE0_IRQ (REFCLK_CNTBase0) — Interrupt generated when the timer condition is met. See registers CNTP_TVAL and CNTP_CTL for the timer condition definition.
68 REFCLK_CNTBASE1_IRQ (REFCLK_CNTBase1) — Interrupt generated when the timer condition is met. See registers CNTP_TVAL and CNTP_CTL for the timer condition definition.
69 REFCLK_CNTBASE2_IRQ (REFCLK_CNTBase2) — Interrupt generated when the timer condition is met. See registers CNTP_TVAL and CNTP_CTL for the timer condition definition.
70 REFCLK_CNTBASE3_IRQ (REFCLK_CNTBase3) — Interrupt generated when the timer condition is met. See registers CNTP_TVAL and CNTP_CTL for the timer condition definition.
71 S32K_CNTBASE0_IRQ (S32K_CNTBase0) — Interrupt generated when the timer condition is met. See registers CNTP_TVAL and CNTP_CTL for the timer condition definition.
72 S32K_CNTBASE1_IRQ (S32K_CNTBase1) — Interrupt generated when the timer condition is met. See registers CNTP_TVAL and CNTP_CTL for the timer condition definition.
96 OSPI0_IRQ (OSPI0)
97 OSPI1_IRQ (OSPI1)
98 AES0_IRQ (AES0)
99 AES1_IRQ (AES1)
101 USB_IRQ (USB) — USB interrupt
102 SDMMC_IRQ (SDMMC) — SDMMC Interrupt request
103 SDMMC_WAKEUP_IRQ (SDMMC) — SDMMC Wakeup event interrupt request
104 CANFD0_IRQ (CANFD0) — CANFD0 Interrupt request
{n+105} HWSEM_IRQ{n} (HWSEM{n}) (n=0..15) — HWSEM interrupt request {n}
{n+124} UART{n}_IRQ (UART{n}) (n=0..7) — UART{n} interrupt request
132 I2C0_IRQ (I2C0) — I2C0 interrupt request
133 I2C1_IRQ (I2C1) — I2C1 interrupt request
134 I2C2_IRQ (I2C2) — I2C2 interrupt request
135 I2C3_IRQ (I2C3) — I2C3 interrupt request
136 I3C_IRQ (I3C) — I3C interrupt request
137 SPI0_IRQ (SPI0) — SPI0 interrupt request
138 SPI1_IRQ (SPI1) — SPI1 interrupt request
139 SPI2_IRQ (SPI2) — SPI2 interrupt request
140 SPI3_IRQ (SPI3) — SPI3 interrupt request
141 I2S0_IRQ (I2S0) — I2S0 interrupt request
142 I2S1_IRQ (I2S1) — I2S1 interrupt request
143 I2S2_IRQ (I2S2) — I2S2 interrupt request
144 I2S3_IRQ (I2S3) — I2S3 interrupt request
145 PDM_WARN_IRQ (PDM) — PDM Warning interrupt request
146 PDM_ERROR_IRQ (PDM) — PDM Error interrupt request
147 PDM_AUDIO_DET_IRQ (PDM) — PDM Audio peak detection interrupt request
148 ETH_SBD_IRQ (ETH) — ETH main interrupt asserted by many events. Its value can also be read via the ETH_STAT0[SBD_INTR_O] bit.
149 ETH_PMT_IRQ (ETH) — Non-maskable interrupt generated when the MAC receives remote wake-up frame or magic packet
151 ADC120_DONE0_IRQ (ADC120) — Averaged sample ready
152 ADC121_DONE0_IRQ (ADC121) — Averaged sample ready
153 ADC122_DONE0_IRQ (ADC122) — Averaged sample ready
154 ADC120_DONE1_IRQ (ADC120) — All samples taken
155 ADC121_DONE1_IRQ (ADC121) — All samples taken
156 ADC122_DONE1_IRQ (ADC122) — All samples taken
157 ADC120_CMPA_IRQ (ADC120) — Comparator A interrupt
158 ADC121_CMPA_IRQ (ADC121) — Comparator A interrupt
159 ADC122_CMPA_IRQ (ADC122) — Comparator A interrupt
160 ADC120_CMPB_IRQ (ADC120) — Comparator B interrupt
161 ADC121_CMPB_IRQ (ADC121) — Comparator B interrupt
162 ADC122_CMPB_IRQ (ADC122) — Comparator B interrupt
163 ADC24_DONE0_IRQ (ADC24) — Averaged sample ready
164 ADC24_DONE1_IRQ (ADC24) — All samples taken
165 ADC24_CMPA_IRQ (ADC24) — Comparator A interrupt
166 ADC24_CMPB_IRQ (ADC24) — Comparator B interrupt
167 CMP0_IRQ (CMP0) — Comparator result changed
168 CMP1_IRQ (CMP1) — Comparator result changed
169 CMP2_IRQ (CMP2) — Comparator result changed
170 CMP3_IRQ (CMP3) — Comparator result changed
{n+171} LPGPIO_IRQ{n} (LPGPIO) (n=0..7) — LPGPIO/LPGPIO_FAST interrupt request {n}
{8n+179} GPIO{n}_IRQ0 (GPIO{n}) (n=0..14) — GPIO{n} interrupt request 0
{8n+180} GPIO{n}_IRQ1 (GPIO{n}) (n=0..14) — GPIO{n} interrupt request 1
{8n+181} GPIO{n}_IRQ2 (GPIO{n}) (n=0..14) — GPIO{n} interrupt request 2
{8n+182} GPIO{n}_IRQ3 (GPIO{n}) (n=0..14) — GPIO{n} interrupt request 3
{8n+183} GPIO{n}_IRQ4 (GPIO{n}) (n=0..14) — GPIO{n} interrupt request 4
{8n+184} GPIO{n}_IRQ5 (GPIO{n}) (n=0..14) — GPIO{n} interrupt request 5
{8n+185} GPIO{n}_IRQ6 (GPIO{n}) (n=0..14) — GPIO{n} interrupt request 6
{8n+186} GPIO{n}_IRQ7 (GPIO{n}) (n=0..14) — GPIO{n} interrupt request 7
{n+299} DMA0_IRQ{n} (DMA0_SEC, DMA0_NS) (n=0..31) — Interrupt request {n}. One per DMA request interface (32 in total).
331 DMA0_IRQ_ABORT (DMA0_SEC, DMA0_NS) — DMAC aborted execution of a program thread.
332 GPU2D_IRQ (GPU2D) — GPU2D aggregated interrupt request
333 CDC_SCANLINE0_IRQ (CDC) — CDC line interrupt
335 CDC_FIFO_WARNING0_IRQ (CDC) — CDC FIFO underrun warning interrupt
337 CDC_FIFO_UNDERRUN0_IRQ (CDC) — CDC layer FIFO underrun interrupt
339 CDC_BUS_ERROR0_IRQ (CDC) — CDC bus error interrupt
341 CDC_REG_RELOAD0_IRQ (CDC) — CDC register reload interrupt
343 DSI_IRQ (DSI) — DSI error interrupt
344 CSI_IRQ (CSI) — CSI interrupt
345 CAM_IRQ (CPI) — CPI interrupt
360 JPEG_XINT_IRQ (JPEG) — JPEG interrupt request
361 JPEG_XINT_NORM_IRQ (JPEG) — JPEG NORM interrupt request
362 JPEG_XINT_ABN_IRQ (JPEG) — JPEG ABN interrupt request
363 JPEG_XINT_IDLE_IRQ (JPEG)
367 ISP_IRQ (ISP) — ISP interrupt request
368 ISP_MI_IRQ (ISP) — ISP MI interrupt request
369 QEC0_CMPA_IRQ (UTIMER) — Channel 12 interrupt request at driver A
370 QEC1_CMPA_IRQ (UTIMER) — Channel 13 interrupt request at driver A
371 QEC2_CMPA_IRQ (UTIMER) — Channel 14 interrupt request at driver A
372 QEC3_CMPA_IRQ (UTIMER) — Channel 15 interrupt request at driver A
373 QEC0_CMPB_IRQ (UTIMER) — Channel 12 interrupt request at driver B
374 QEC1_CMPB_IRQ (UTIMER) — Channel 13 interrupt request at driver B
375 QEC2_CMPB_IRQ (UTIMER) — Channel 14 interrupt request at driver B
376 QEC3_CMPB_IRQ (UTIMER) — Channel 15 interrupt request at driver B
{n+377} UTIMER_IRQ{n} (UTIMER) (n=0..7) — Channel 0, interrupt request {n}
{n+377} UTIMER_IRQ{n} (UTIMER) (n=8..15) — Channel 1, interrupt request {n}
{n+377} UTIMER_IRQ{n} (UTIMER) (n=16..23) — Channel 2, interrupt request {n}
{n+377} UTIMER_IRQ{n} (UTIMER) (n=24..31) — Channel 3, interrupt request {n}
{n+377} UTIMER_IRQ{n} (UTIMER) (n=32..39) — Channel 4, interrupt request {n}
{n+377} UTIMER_IRQ{n} (UTIMER) (n=40..47) — Channel 5, interrupt request {n}
{n+377} UTIMER_IRQ{n} (UTIMER) (n=48..55) — Channel 6, interrupt request {n}
{n+377} UTIMER_IRQ{n} (UTIMER) (n=56..63) — Channel 7, interrupt request {n}
{n+377} UTIMER_IRQ{n} (UTIMER) (n=64..71) — Channel 8, interrupt request {n}
{n+377} UTIMER_IRQ{n} (UTIMER) (n=72..79) — Channel 9, interrupt request {n}
{n+377} UTIMER_IRQ{n} (UTIMER) (n=80..87) — Channel 10, interrupt request {n}
{n+377} UTIMER_IRQ{n} (UTIMER) (n=88..95) — Channel 11, interrupt request {n}
476 GPIO16_IRQ (GPIO16)
477 GPIO17_IRQ (GPIO17)
